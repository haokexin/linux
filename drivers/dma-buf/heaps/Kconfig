## drivers/dma-buf/heaps/Kconfig
```kconfig
menuconfig DMABUF_HEAPS_DEFERRED_FREE
	bool "DMA-BUF heaps deferred-free library"
	help
	  Choose this option to enable the DMA-BUF heaps deferred-free library.

menuconfig DMABUF_HEAPS_PAGE_POOL
	bool "DMA-BUF heaps page-pool library"
	help
	  Choose this option to enable the DMA-BUF heaps page-pool library.

config DMABUF_HEAPS_SYSTEM
	tristate "DMA-BUF System Heap"
	depends on DMABUF_HEAPS
	select DMABUF_HEAPS_PAGE_POOL
	help
	  Choose this option to enable the system dmabuf heap. The system heap
	  is backed by pages from the buddy allocator. If in doubt, say Y.

config DMABUF_HEAPS_SECURE
	tristate "DMA-BUF Secure Heap"
	depends on DMABUF_HEAPS && DMABUF_HEAPS_DEFERRED_FREE
	help
	  Choose this option to enable the secure dmabuf heap. The secure heap
	  is allocated by gen allocater. it's allocated according the dts.
	  If in doubt, say Y.

config DMABUF_HEAPS_CMA
	tristate "DMA-BUF CMA Heap"
	depends on DMABUF_HEAPS && DMA_CMA
	help
	  Choose this option to enable dma-buf CMA heap. This heap is backed
	  by the Contiguous Memory Allocator (CMA). If your system has these
	  regions, you should say Y here.

config DMABUF_HEAPS_CMA_BST
	tristate "DMA-BUF CMA Heap for BST"
	depends on DMABUF_HEAPS && DMA_CMA
	select DMABUF_MSGBX_R5MEM
	default n
	help
	  Choose this option to enable dma-buf CMA heap for BST. This heap is
	  backed by the Contiguous Memory Allocator (CMA). If your system has
	  these regions, you should say Y here.

config DMABUF_MSGBX_R5MEM
	bool "DMA-BUF Gotten by Msbox from SOC R5"
	depends on DMABUF_HEAPS && DMA_CMA && BST_IPC_MSGBX
	default n
	help
	  Choose this option to enable dma-buf CMA heap gotten by msgbox from
	  SOC R5. If your board supports msgbx, you will get dma-buf address 
	  from SOC R5. And you can use this buffer with dma-buf API. All pids
	  are PID0(ADAS : CPU_0, IVI : CPU_4, DB : CPUMP2_0)

config DMABUF_HEAPS_SRAM
	bool "DMA-BUF SRAM Heap"
	depends on DMABUF_HEAPS
	default n
	help
	  Choose this option to enable the SRAM heap. This heap is backed by
	  the SRAM region. If your system has these regions, you should say Y
	  here.
```

## drivers/gpu/drm/bst-native-drm/Kconfig
```kconfig
# SPDX-License-Identifier: GPL-2.0
menu "BST native display devices"

config DRM_BST_NATIVE_DISPLAY
	tristate "BST Display Processor for native"
	depends on DRM && OF && (ARM || ARM64 || COMPILE_TEST)
	depends on COMMON_CLK
	select DRM_GEM_DMA_HELPER
	select DRM_KMS_HELPER
	select VIDEOMODE_HELPERS
	help
	  Choose this option if you want to compile the BST Display
	  Processor driver.

	  If compiled as a module it will be called bst-native-drm.

config DRM_BST_DC
	tristate "BST DC: control DC driver"
	default y
	help
	  Choose y to include the dc driver. Driver controls the dc
	  functionalities.

config DRM_BST_VOUT
	tristate "BST VOUT: vout connector driver"
	default y
	help
	  Choose y to include the dc driver. Driver controls the dc
	  functionalities.

config DRM_BST_DPTX
	tristate "BST DP TX: control DP Tx driver"
	select DRM_DISPLAY_HELPER
	select DRM_DISPLAY_DP_HELPER
	default y
	help
	  Choose y to include the dptx driver. Driver controls the main DP Tx
	  functionalities.
config DRM_BST_LVDS
	tristate "BST LVDS: control LVDS driver"
	default y
	help
	  Choose y to include the LVDS driver. Driver controls the LVDS
	  functionalities.
config DRM_BST_MIPI_DSI
	tristate "BST MIPI DSI: control MIPI DSI driver"
	default y
	help
	  Choose y to include the MIPI DSI driver. Driver controls the MIPI DSI
	  functionalities.

endmenu
```

## drivers/gpu/drm/bst-virtual-drm/Kconfig
```kconfig
# SPDX-License-Identifier: GPL-2.0+
menu "BST Virtual Display devices"

config DRM_BST_VIRTUAL_DISPLAY
	tristate "BST Display Processor for Vritual"
	depends on DRM && OF && (ARM || ARM64 || COMPILE_TEST)
	depends on COMMON_CLK
	select DRM_GEM_DMA_HELPER
	select DRM_KMS_HELPER
	select VIDEOMODE_HELPERS
	select DRM_DISPLAY_HELPER
	select DRM_DISPLAY_DP_HELPER
	help
	  Choose this option if you want to compile the BST Display
	  Processor driver.

	  If compiled as a module it will be called bst-virtual-drm.

config DRM_BST_FW_MSGBX
	tristate "BST Display Firmware MessageBox Dirver"
	default n
	help
	  Choose this option if you want to compile the display firmware.
	  functionalities.

config DRM_BST_FW_IPC
	tristate "BST Display Firmware IPC Dirver"
	default y
	help
	  Choose this option if you want to compile the display firmware.
	  functionalities.

endmenu
```

## drivers/i3c/slave/Kconfig
```kconfig
# SPDX-License-Identifier: GPL-2.0-only
config SVC_I3C_SLAVE
	tristate "Silvaco I3C Dual-Role Slave driver"
	depends on I3C
	help
	  Support for Silvaco I3C Dual-Role Slave Controller.
```

## drivers/input/touchscreen/bst/Kconfig
```kconfig
config TOUCHSCREEN_VIRT_BST
	tristate "BST virt touch driver support"
	help
	  general driver for virt touch from BST

config TOUCHSCREEN_VIRT_BST_DEBUG_STATISTICS_DELAY_TIMESTAMPS
	tristate "BST virt touch driver debug statistics coord timestamps and delay time"
	select TOUCHSCREEN_VIRT_BST
	default n
	help
	  Enable the debug statistics coord timestamps and delay time for BST virt touch driver.

	  Please select the option that matches TOUCHSCREEN_VIRT_BST.
	  If TOUCHSCREEN_VIRT_BST=y, say Y or N.
	  If TOUCHSCREEN_VIRT_BST=m, say M or N.
	  if unsure, say N.
```

## drivers/iommu/arm/arm-smmu-v3/bst/Kconfig
```kconfig
# SPDX-License-Identifier: GPL-2.0
config COREIP_SMMMU_MULTIOS_BST
	tristate "coreip_smmu support multi_os for BST"
	depends on ARM_SMMU_V3 && ARCH_BSTC1200
	select SMMU_MSGBX_R5MAP
	default y
	help
	  Choose this option to enable shared coreip_smmu across multiple systems for BST.

config SMMU_MSGBX_R5MAP
	bool "By Msgbx notify safety-r5 create io-pgtable"
	depends on BST_IPC_MSGBX
	default n
	help
	  Choose this option to enable by msgbx notify safety-r5 to create a page table for BST.
```

## drivers/media/i2c/bst/Kconfig
```kconfig
config VIDEO_BST_DEV
	tristate "BST video peripheral device driver"
	select V4L2_FWNODE
	help
	  Video peripheral device driver for BST ISP
```

## drivers/media/platform/bst-c1200/Kconfig
```kconfig
config VIDEO_BST_C1200_ISP
	tristate "BST ISP Video Input Driver"
	depends on VIDEO_DEV && VIDEO_V4L2_SUBDEV_API && MEDIA_CONTROLLER
	select VIDEOBUF2_CORE
	select V4L2_FWNODE
	select VIDEOBUF2_MEMOPS
	select VIDEOBUF2_DMA_CONTIG
	select BST_COREIP
	help
	  Support for BST Video Input driver.

config BST_C1200_CSI2_RX
	tristate "BST ISP Video Input Phy Receiver Driver"
	depends on VIDEO_DEV && VIDEO_V4L2_SUBDEV_API && OF
	select V4L2_FWNODE
	help
	  Support for BST Video Phy Receiver driver.

config BST_C1200_CSITX
	tristate "BST ISP Video CSI Output Driver"
	depends on VIDEO_DEV && VIDEO_V4L2_SUBDEV_API && OF
	select V4L2_FWNODE
	help
	  Support for BST ISP Video CSI Output Driver.
```

## drivers/media/platform/bst-csitx/Kconfig
```kconfig
config BST_C1200_CSITX
	tristate "BST ISP Video CSI Output Driver"
	depends on VIDEO_DEV && VIDEO_V4L2_SUBDEV_API && OF
	select V4L2_FWNODE
	help
	  Support for BST ISP Video CSI Output Driver.
```

## drivers/media/platform/bst-isp/Kconfig
```kconfig
# SPDX-License-Identifier: GPL-2.0-only

comment "BST media platform drivers"

config VIDEO_BST_ISP
	tristate "BST ISP Video Input Driver"
	select IOMMU_API
	select OF
	select V4L2_FWNODE
	select VIDEOBUF2_DMA_CONTIG
	select VIDEO_BST_DEV
	help
	  Support for BST Video Input driver.

config VIDEO_BST_ISP_MULTI_OS
	tristate "BST ISP Video Input Driver"
	default n
	help
	  Use ISP simultaneously by multiple OS
```

## drivers/misc/bst/Kconfig
```kconfig
# SPDX-License-Identifier: GPL-2.0-only
#
# Minidump support for BST.
#

menuconfig BST_SOLUTION
	bool "Bst Properitary Configuration"
	depends on KEXEC
	default n
	help
	  Say y here to get to see options for minidump support for
	  BST. This option depends on KEXEC.

	  If you say N, all options in this submenu will be skipped
	  and disabled.

if BST_SOLUTION

source "drivers/misc/bst/aee/Kconfig"

endif
```

## drivers/misc/bst/aee/Kconfig
```kconfig
config BST_AEE_FEATURE
	tristate "Enable Android Exception Enhancement"
	default y
	select TRACER_SNAPSHOT if FTRACE
	help
	  AEE (Android Exception Engine) that designed by  Mediatek is an
	  exception catching and debugging information generation mechanism.
	  It can collect and dump information to filesystem
	  (/sdcard/bstlog/aee_exp)  when fatel occur(E.g. kernel
	  panic/android system server crash and ..)

config BST_AEE_AED
	tristate "Enable AEE Kernel Exception Report Daemon"
	default y
	help
	  BST_AEE_AED is the kernel config of aed, which is the base support for
	  aee features. Such as:
	  aed debug: some test case for aee driver itself
	  aed main: aed main function and ioctl for user space aee
	  monitor hang: detect hang feature...

config BST_AEE_IPANIC
	tristate "Enable AEE Kernel Panic Dump"
	default y
	help
	  BST_AEE_IPANIC is the kernel config of ipanic feature designed by
	  BST, which is the enhancement of kernel defaut panic flow, and combine
	  with aee.
	  It do some hook function and get some kernel panic information for debug.

config BST_AEE_POWERKEY_HANG_DETECT
	bool "powerkey monitor"
	default n
	help
	  BST_AEE_POWERKEY_HANG_DETECT is the kernel config of hang feature
	  designed by BST, which is a debug feature for detect device hang.
	  When the device hang and can detect by this mechanism, it will notice
	  user space aee and get some debug information.

config BST_AEE_MRDUMP
	bool "BST-RAMDUMP support"
	default y
	help
	  BST_AEE_MRDUMP is the kernel config of MRDUMP feature
	  MRDUMP (Memory RAM Dump) based on MT-RAMDUMP is designed as a memory
	  dump mechanism for debugging system to dump DRAM content at BST
	  android phone platform

config BST_AEE_MRDUMP_WDT
	bool "BST-MRDUMP WDT support"
	default n
	help
	  Support dump crash information from watchdog.

	  If say y, you can dump information from watchdog, and it will send SMC to ATF.
	  The current BST ATF doesn't support the type of SMC call from mrdump.
	  So you should use this function after supporting the type of SMC.
```

## drivers/net/can/bst/Kconfig
```kconfig
config CAN_BST_FLEXCAN
	tristate "Support for BST FLEXCAN"
	depends on OF && HAS_IOMEM
	select CAN_RX_OFFLOAD
	help
	  Say Y here if you want to support for BST FlexCAN.
```

## drivers/net/can/bst_vcan/Kconfig
```kconfig
config BST_VCAN
	tristate "Support BST vcan"
	depends on ARM64
	depends on !C1200_SLT && !C1200_MASS
	default y
	help
	  BST vcan is a virtual CAN driver for the BST platform.

	  To compile as a module, choose M here: the module will be called
	  bst_vcan.

config VCAN_DEBUG
    tristate "Test for BST vcan"
    depends on ARM64
	depends on !C1200_SLT && !C1200_MASS
    default m
    help
      Say Y here if you want to test delay for BST vcan.
```

## drivers/net/ethernet/bst/hif/Kconfig
```kconfig
config BST_HIF_ETH
	tristate "bst vmac hif driver"
    depends on (BST_C1200_DB || BST_C1200_IVI)
	default y
	help
	  This is the driver for the vmac hif.
```

## drivers/net/ethernet/bst/pcie-virtnet/Kconfig
```kconfig
# SPDX-License-Identifier: GPL-2.0
#
# BST virtual ethernet configuration
#

config BST_PCIE_VIRTNET
	tristate "BST_PCIE new virtual ethernet support"
	default y
	depends on PCIE_BST
	help
	  This is the driver for the PCIE virtual ethernet built around a
	  BlackSesame SOC.
```

## drivers/net/ethernet/bst/vmac/Kconfig
```kconfig
config BST_VMAC_ETH
	tristate "bst vmac Ethernet driver"
	depends on (BST_C1200_DB || BST_C1200_IVI)
	default y
	help
	  This is the driver for the Ethernet IPs built around a
	  	IMG IP Core.

if BST_VMAC_ETH

config BST_VMAC_PLATFORM
	tristate "bst vmac platform bus support"
	depends on BST_VMAC_ETH
	default y
	help
	  This selects the platform specific bus support for the BST VMAC driver.
	  This is the driver used on several SoCs:
	  BST C1200

	  If you have a controller with this interface, say Y or M here.

	  If unsure, say N.

endif
```

## drivers/pci/controller/bst/Kconfig
```kconfig
# SPDX-License-Identifier: GPL-2.0

menu "BlackSesame SOC PCIe Core Support"
	depends on PCI && ARCH_BST

config PCIE_BST
	bool

config PCIE_BST_HOST
	bool
	select PCIE_BST

config PCIE_BST_EP
	bool
	select PCIE_BST

config PCIE_BST_PLAT
	bool

config PCIE_BST_PLAT_HOST
	bool "BlackSesame SOC PCIe controller - Host mode"
	depends on PCI_MSI_IRQ_DOMAIN
	select PCIE_BST_HOST
	select PCIE_BST_PLAT

config PCIE_BST_PLAT_EP
	bool "BlackSesame SOC PCIe controller - Endpoint mode"
	depends on PCI && PCI_MSI_IRQ_DOMAIN
	depends on PCI_ENDPOINT
	select PCIE_BST_EP
	select PCIE_BST_PLAT

config PCIE_BST_EP_USE_OUTBOUND
	bool "C1200 EP mode uses outbound"
	default n
	select PCIE_BST_PLAT_EP

config PCIE_BST_DIAGNOSTIC
	bool "C1200 PCIE DIAGNOSTIC"
	default y

config PCIE_BST_RESET
	bool "C1200 PCIE BST RESET"
	default y

config HAVE_DBI_MUTEX
	bool "BST C1200 PCIe Shared DBI Lock"
	default n

endmenu
```

## drivers/phy/bst/Kconfig
```kconfig
#SPDX-License-Identifier: GPL-2.0+
#
#Phy drivers for BST platforms
#
config PHY_BST_USB
    tristate "Black Sesame Technologies USB PHY Driver"
    select GENERIC_PHY
    help
        Enable this to support the USB PHY on BST SoCs.This driver controls both the
        USB 2 PHY and the USB 3 PHY.
```

## drivers/pinctrl/bst/Kconfig
```kconfig
if (ARCH_BST || COMPILE_TEST)

 
config BST_PINCTRL_C1200
        tristate "bst pinctrl c1200"
        help
        This is the pinctrl, pinmux, pinconf driver for the
        iomux block found in the BST C1200 platform.

endif
```

## drivers/soc/bst/c1200/Kconfig
```kconfig
config SIP_SMC_CLK
	tristate "BST clk rst driver smcc"
	help
	  This is essentially kernel send message to user for safety function to excute el3.
```

## drivers/spi/bst/Kconfig
```kconfig
config VIRTUAL_QSPI
	tristate "qspi virtual support"
	help
	  This supports qspi virtual block.

	  Note that this application programming interface is EXPERIMENTAL
	  and hence SUBJECT TO CHANGE WITHOUT NOTICE while it stabilizes.
	  

config VIRTUAL_TOTAL_SIZE
	int "virtual device size in KiB"
	depends on VIRTUAL_QSPI
	default "32768"
	help
	  This allows you to configure the total size of the virtual device
	  emulated by the virtual driver.  If the virtual driver is built
	  as a module, it is also possible to specify this as a parameter when
	  loading the module.

config VIRTUAL_ERASE_SIZE
	int "virtual erase block size in KiB"
	depends on VIRTUAL_QSPI
	default "4"
	help
	  This allows you to configure the size of the erase blocks in the
	  device emulated by the virtual driver.  If the virtual driver is built
	  as a module, it is also possible to specify this as a parameter when
	  loading the module.
```

## drivers/ufs/host/bst/Kconfig
```kconfig
config SCSI_UFS_BST
	tristate "DesignWare platform support using a BST C1200 Chip"
	depends on SCSI_UFSHCD_PLATFORM
	help
	  Synopsys Test Chip is a PHY for prototyping purposes.

	  If unsure, say N.

config BST_UFS_MULSYS
	tristate "ufs used for multisystem"
	depends on SCSI_UFS_BST
	help
	  ufs used for multisystem.

	  If unsure, say N.

config BST_UFS_UTRD_SLOT_START
	int "ufs's utrd used slot"
	depends on BST_UFS_MULSYS
	default 0
	help
	  ufs's utrd used slot.

	  If unsure, say N.

config BST_UFS_UTRD_SLOT_NUMBER
	int "ufs's utrd used slot number"
	depends on BST_UFS_MULSYS
	default 1
	help
	  ufs's utrd used slot number.

	  If unsure, say N.

config BST_UFS_UTMRD_SLOT_START
	int "ufs's utmrd used slot"
	depends on BST_UFS_MULSYS
	default 0
	help
	  ufs's utmrd used slot.

	  If unsure, say N.

config BST_UFS_UTMRD_SLOT_NUMBER
	int "ufs's utmrd used slot number"
	depends on BST_UFS_MULSYS
	default 1
	help
	  ufs's utmrd used slot number.

	  If unsure, say N.

config BST_UFS_DEVICE_NUMBER
	int "ufs used devices number"
	depends on BST_UFS_MULSYS
	default 0
	help
	  ufs used devices number.

	  If unsure, say N.
```
