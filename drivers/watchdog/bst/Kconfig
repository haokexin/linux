## drivers/watchdog/bst/Kconfig
```kconfig
config BST_WATCHDOG
	tristate "BST watchdog"
	depends on HAS_IOMEM
	select WATCHDOG_CORE
	help
	  Say Y here if to include support for the BST watchdog 
	  timer found in many chips.
	  To compile this driver as a module, choose M here: the
	  module will be called bst_wdt.

config BST_WATCHDOG_DEBUG
	bool "bst watchdog test"
	depends on BST_WATCHDOG

config BST_WATCHDOG_SLT
	bool "bst watchdog test"
	depends on BST_WATCHDOG

config BST_WATCHDOG_FIREWALL_OFF
	bool "bst watchdog for safety sysnoc firewall off"
	depends on BST_WATCHDOG

config BST_AUTOFEED_A78_WATCHDOG
        bool "bst create kthread auto feed a78 watchdog"
        depends on BST_WATCHDOG
```

## drivers/xrp/Kconfig
```kconfig
menu "HIFI5 XRP driver"
config XRP
    tristate "XRP driver" 
config XRP_DEBUG
    bool "Debug XRP"
    depends on XRP    
config XRP_HW_SIMPLE
    tristate "XRP for simple hardware"
    depends on XRP    
config XRP_HW_HIKEY960
    tristate "XRP for HiKey960"
    depends on XRP
config XRP_HW_BST
    tristate "XRP for BST"
    depends on XRP 
endmenu
```

## drivers/xrp/ipc/Kconfig
```kconfig
config XRP_IPC
    tristate "XRP_IPC driver"
    
config XRP_IPC_DEBUG
    bool "Debug XRP IPC"
    depends on XRP_IPC
    
config XRP_IPC_STATE_MGT_ENABLE
    tristate "enable XRP_IPC_STATE_MGT_ENABLE for ipc"
    depends on XRP_IPC
    
config XRP_IPC_FLT_MGT_ENABLE
    tristate "enable XRP_IPC_FLT_MGT_ENABLE for ipc"
    depends on XRP_IPC


#test
```

## sound/soc/bst/Kconfig
```kconfig
config SND_BST_I2S
	tristate "BST I2S Device Driver"
	#depends on CLKDEV_LOOKUP
	select SND_SOC_GENERIC_DMAENGINE_PCM
	help
	 Say Y or M if you want to add support for I2S driver for
	 Synopsys designware I2S device.
	 The device supports up to a maximum of 8 channels each for
	 play and record.

config SND_BST_PCM
	bool "PCM PIO extension for I2S driver"
	depends on SND_BST_I2S
	help
	 Say Y or N if you want to add a custom ALSA extension that registers
	 a PCM and uses PIO to transfer data.

	 This functionality is specially suited for I2S devices that don't have
	 DMA support.

	
config SND_BST_TDM
	tristate "BST TDM Device Driver"
	#depends on CLKDEV_LOOKUP
	select SND_SOC_GENERIC_DMAENGINE_PCM
	help
	 Say Y or M if you want to add support for TDM driver for
	 Synopsys designware TDM device.
	 The device supports up to a maximum of 16 channels each for
	 play and record.

config SND_BST_PCM_TDM
	bool "PCM PIO extension for TDM driver"
	depends on SND_BST_TDM
	help
	 Say Y or N if you want to add a custom ALSA extension that registers
	 a PCM and uses PIO to transfer data.

	 This functionality is specially suited for TDM devices that don't have
	 DMA support.
```
