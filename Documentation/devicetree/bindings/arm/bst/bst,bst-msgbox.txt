## arch/arm64/configs/bstc1200_ivi_minidump_defconfig
```kconfig
CONFIG_COMPILE_TEST=y
CONFIG_DEFAULT_HOSTNAME="BST-C1200"
CONFIG_SYSVIPC=y
CONFIG_HIGH_RES_TIMERS=y
CONFIG_PREEMPT=y
CONFIG_IKCONFIG=y
CONFIG_IKCONFIG_PROC=y
CONFIG_LOG_BUF_SHIFT=21
CONFIG_NAMESPACES=y
CONFIG_BLK_DEV_INITRD=y
# CONFIG_FHANDLE is not set
CONFIG_KCMP=y
CONFIG_EMBEDDED=y
CONFIG_ARCH_BSTC1200=y
CONFIG_ARCH_BST=y
# CONFIG_ARM64_ERRATUM_826319 is not set
# CONFIG_ARM64_ERRATUM_827319 is not set
# CONFIG_ARM64_ERRATUM_824069 is not set
# CONFIG_ARM64_ERRATUM_819472 is not set
# CONFIG_ARM64_ERRATUM_832075 is not set
# CONFIG_ARM64_ERRATUM_1742098 is not set
# CONFIG_ARM64_ERRATUM_845719 is not set
# CONFIG_ARM64_ERRATUM_843419 is not set
# CONFIG_ARM64_ERRATUM_1024718 is not set
# CONFIG_ARM64_ERRATUM_1418040 is not set
# CONFIG_ARM64_ERRATUM_1165522 is not set
# CONFIG_ARM64_ERRATUM_1319367 is not set
# CONFIG_ARM64_ERRATUM_1530923 is not set
# CONFIG_ARM64_ERRATUM_1286807 is not set
# CONFIG_ARM64_ERRATUM_1463225 is not set
# CONFIG_ARM64_ERRATUM_1542419 is not set
# CONFIG_ARM64_ERRATUM_1508412 is not set
# CONFIG_ARM64_ERRATUM_2051678 is not set
# CONFIG_ARM64_ERRATUM_2077057 is not set
# CONFIG_ARM64_ERRATUM_2658417 is not set
# CONFIG_ARM64_ERRATUM_2054223 is not set
# CONFIG_ARM64_ERRATUM_2067961 is not set
# CONFIG_ARM64_ERRATUM_2457168 is not set
# CONFIG_CAVIUM_ERRATUM_22375 is not set
# CONFIG_CAVIUM_ERRATUM_23154 is not set
# CONFIG_CAVIUM_ERRATUM_27456 is not set
# CONFIG_CAVIUM_ERRATUM_30115 is not set
# CONFIG_CAVIUM_TX2_ERRATUM_219 is not set
# CONFIG_FUJITSU_ERRATUM_010001 is not set
# CONFIG_HISILICON_ERRATUM_161600802 is not set
# CONFIG_QCOM_FALKOR_ERRATUM_1003 is not set
# CONFIG_QCOM_FALKOR_ERRATUM_1009 is not set
# CONFIG_QCOM_QDF2400_ERRATUM_0065 is not set
# CONFIG_QCOM_FALKOR_ERRATUM_E1041 is not set
# CONFIG_NVIDIA_CARMEL_CNP_ERRATUM is not set
# CONFIG_SOCIONEXT_SYNQUACER_PREITS is not set
CONFIG_ARM64_VA_BITS_48=y
CONFIG_SCHED_MC=y
CONFIG_SCHED_SMT=y
CONFIG_NR_CPUS=8
CONFIG_HZ_100=y
CONFIG_CRASH_DUMP=y
CONFIG_SECOND_KERNEL=y
CONFIG_BST_C1200_IVI=y
CONFIG_COMPAT=y
CONFIG_RANDOMIZE_BASE=y
CONFIG_ARM_PSCI_CPUIDLE=y
# CONFIG_ARM_PSCI_CPUIDLE_DOMAIN is not set
CONFIG_JUMP_LABEL=y
CONFIG_MODULES=y
CONFIG_MODULE_UNLOAD=y
CONFIG_PARTITION_ADVANCED=y
CONFIG_BINFMT_MISC=y
CONFIG_SLAB_FREELIST_RANDOM=y
CONFIG_KSM=y
CONFIG_DEFAULT_MMAP_MIN_ADDR=65536
CONFIG_TRANSPARENT_HUGEPAGE=y
CONFIG_TRANSPARENT_HUGEPAGE_MADVISE=y
CONFIG_CLEANCACHE=y
CONFIG_CMA=y
CONFIG_IDLE_PAGE_TRACKING=y
# CONFIG_ZONE_DMA is not set
# CONFIG_ZONE_DMA32 is not set
CONFIG_USERFAULTFD=y
CONFIG_NET=y
CONFIG_PACKET=y
CONFIG_UNIX=y
CONFIG_INET=y
CONFIG_IP_MULTICAST=y
CONFIG_IP_ADVANCED_ROUTER=y
CONFIG_IP_MULTIPLE_TABLES=y
CONFIG_IP_PNP=y
CONFIG_IP_PNP_DHCP=y
CONFIG_IP_PNP_BOOTP=y
CONFIG_IP_PNP_RARP=y
CONFIG_INET_UDP_DIAG=y
CONFIG_INET_DIAG_DESTROY=y
CONFIG_NETWORK_SECMARK=y
CONFIG_NET_SCHED=y
CONFIG_NET_SCH_HTB=y
CONFIG_NET_SCH_TBF=y
CONFIG_NET_CLS_U32=y
CONFIG_NET_EMATCH=y
CONFIG_NET_EMATCH_U32=y
CONFIG_PCI=y
CONFIG_PCI_REALLOC_ENABLE_AUTO=y
CONFIG_PCI_IOV=y
CONFIG_PCI_ENDPOINT=y
CONFIG_PCI_ENDPOINT_CONFIGFS=y
CONFIG_PCI_EPF_TEST=y
# CONFIG_BST_CVSMM is not set
# CONFIG_BST_HWCV is not set
CONFIG_UEVENT_HELPER=y
CONFIG_DEVTMPFS=y
CONFIG_DEVTMPFS_MOUNT=y
# CONFIG_FW_CACHE is not set
# CONFIG_G78_DMA_SHARED_BUFFER_EXPORTER is not set
CONFIG_ARM_SCMI_PROTOCOL=y
# CONFIG_EFI_CUSTOM_SSDT_OVERLAYS is not set
CONFIG_BLK_DEV_LOOP=y
CONFIG_BLK_DEV_RAM=y
CONFIG_BLK_DEV_RAM_SIZE=8192
CONFIG_BLK_DEV_NVME=y
CONFIG_DUMMY_IRQ=y
CONFIG_SCSI=y
CONFIG_BLK_DEV_SD=y
CONFIG_NETDEVICES=y
# CONFIG_BST_VMAC_ETH is not set
CONFIG_MARVELL_PHY=y
CONFIG_INPUT_TOUCHSCREEN=y
CONFIG_VT_HW_CONSOLE_BINDING=y
CONFIG_SERIAL_8250=y
CONFIG_SERIAL_8250_CONSOLE=y
CONFIG_SERIAL_8250_NR_UARTS=8
CONFIG_SERIAL_8250_RUNTIME_UARTS=5
CONFIG_SERIAL_8250_EXTENDED=y
CONFIG_SERIAL_8250_MANY_PORTS=y
CONFIG_SERIAL_8250_SHARE_IRQ=y
CONFIG_SERIAL_8250_DW=y
CONFIG_SERIAL_OF_PLATFORM=y
CONFIG_SERIAL_DEV_BUS=y
CONFIG_TTY_PRINTK=y
# CONFIG_HW_RANDOM is not set
CONFIG_I2C=y
CONFIG_I2C_CHARDEV=y
CONFIG_I2C_DESIGNWARE_SLAVE=y
CONFIG_I2C_DESIGNWARE_PLATFORM=y
CONFIG_PINCTRL=y
CONFIG_BST_PINCTRL_C1200=y
CONFIG_GPIO_SYSFS=y
CONFIG_GPIO_DWAPB=y
CONFIG_WATCHDOG=y
CONFIG_WATCHDOG_SYSFS=y
CONFIG_MFD_SM501=y
# CONFIG_MEDIA_CEC_SUPPORT is not set
CONFIG_MEDIA_SUPPORT=y
# CONFIG_MEDIA_CAMERA_SUPPORT is not set
# CONFIG_MEDIA_ANALOG_TV_SUPPORT is not set
# CONFIG_MEDIA_DIGITAL_TV_SUPPORT is not set
# CONFIG_MEDIA_RADIO_SUPPORT is not set
# CONFIG_MEDIA_SDR_SUPPORT is not set
# CONFIG_MEDIA_PLATFORM_SUPPORT is not set
# CONFIG_MEDIA_TEST_SUPPORT is not set
# CONFIG_DRM_BST_DC is not set
# CONFIG_DRM_BST_DPTX is not set
# CONFIG_DRM_BST_LVDS is not set
# CONFIG_DRM_BST_MIPI_DSI is not set
CONFIG_BACKLIGHT_CLASS_DEVICE=y
CONFIG_SOUND=y
CONFIG_SND=y
CONFIG_SND_DYNAMIC_MINORS=y
CONFIG_SND_SOC=y
CONFIG_SND_SOC_IMX_AUDMUX=y
CONFIG_SND_SOC_AC97_CODEC=y
CONFIG_SND_SOC_ES8316=y
CONFIG_SND_SOC_PCM3168A_I2C=y
CONFIG_SND_SOC_PCM5102A=y
CONFIG_SND_SOC_SPDIF=y
CONFIG_SND_SIMPLE_CARD=y
# CONFIG_HID is not set
# CONFIG_USB_SUPPORT is not set
CONFIG_MMC=y
CONFIG_MMC_DEBUG=y
CONFIG_MMC_SDHCI=y
CONFIG_MMC_SDHCI_PLTFM=y
CONFIG_SCSI_UFSHCD=y
CONFIG_SCSI_UFS_BSG=y
CONFIG_SCSI_UFSHCD_PCI=y
CONFIG_SCSI_UFSHCD_PLATFORM=y
CONFIG_SCSI_UFS_BST=y
CONFIG_BST_UFS_MULSYS=y
CONFIG_BST_UFS_UTRD_SLOT_START=16
CONFIG_BST_UFS_UTRD_SLOT_NUMBER=8
CONFIG_BST_UFS_UTMRD_SLOT_START=2
CONFIG_BST_UFS_DEVICE_NUMBER=7
CONFIG_DMADEVICES=y
CONFIG_SYNC_FILE=y
CONFIG_STAGING=y
CONFIG_COMMON_CLK_SCMI=y
CONFIG_ARM_SMMU_V3=y
CONFIG_REMOTEPROC=y
# CONFIG_ANDROID_KABI_RESERVE is not set
# CONFIG_ANDROID_VENDOR_OEM_DATA is not set
CONFIG_DAX=y
CONFIG_NVMEM=y
CONFIG_BST_IPC_MSGBX=y
# CONFIG_BSTN is not set
# CONFIG_BST_BSTNPU is not set
# CONFIG_BST_LWNN is not set
# CONFIG_BST_FUSA_INJECT is not set
CONFIG_EXT2_FS=y
CONFIG_EXT4_FS=y
CONFIG_EXT4_FS_POSIX_ACL=y
CONFIG_EXT4_FS_SECURITY=y
CONFIG_EXPORTFS_BLOCK_OPS=y
CONFIG_FANOTIFY=y
CONFIG_QUOTA=y
CONFIG_QFMT_V2=y
CONFIG_AUTOFS4_FS=y
CONFIG_FSCACHE=y
CONFIG_FSCACHE_STATS=y
CONFIG_CACHEFILES=y
CONFIG_CACHEFILES_DEBUG=y
CONFIG_MSDOS_FS=y
CONFIG_VFAT_FS=y
CONFIG_FAT_DEFAULT_UTF8=y
CONFIG_EXFAT_FS=y
CONFIG_NTFS_FS=y
CONFIG_NTFS_RW=y
CONFIG_PROC_KCORE=y
CONFIG_TMPFS=y
CONFIG_TMPFS_POSIX_ACL=y
CONFIG_NLS_DEFAULT="utf8"
CONFIG_NLS_CODEPAGE_437=y
CONFIG_NLS_ISO8859_1=y
CONFIG_NLS_UTF8=y
CONFIG_KEYS=y
CONFIG_LSM=""
CONFIG_CRYPTO_NULL=y
CONFIG_CRYPTO_RSA=y
CONFIG_CRYPTO_AES=y
CONFIG_CRYPTO_CBC=y
CONFIG_CRYPTO_CTR=y
CONFIG_CRYPTO_CMAC=y
CONFIG_CRYPTO_GHASH=y
CONFIG_CRYPTO_HMAC=y
CONFIG_CRYPTO_MD4=y
CONFIG_CRYPTO_SHA256=y
CONFIG_CRYPTO_SHA512=y
CONFIG_CRYPTO_SHA3=y
CONFIG_CRYPTO_CRC32=y
CONFIG_CRYPTO_DEFLATE=y
CONFIG_CRYPTO_LZ4=y
CONFIG_CRYPTO_LZ4HC=y
CONFIG_CRYPTO_ZSTD=y
CONFIG_CRYPTO_JITTERENTROPY=y
CONFIG_ASYMMETRIC_KEY_TYPE=y
CONFIG_ASYMMETRIC_PUBLIC_KEY_SUBTYPE=y
CONFIG_X509_CERTIFICATE_PARSER=y
CONFIG_PKCS7_MESSAGE_PARSER=y
CONFIG_SYSTEM_TRUSTED_KEYRING=y
CONFIG_INDIRECT_PIO=y
CONFIG_CRC_T10DIF=y
CONFIG_DMA_CMA=y
CONFIG_IRQ_POLL=y
CONFIG_PRINTK_TIME=y
CONFIG_PRINTK_CALLER=y
CONFIG_DYNAMIC_DEBUG=y
CONFIG_DEBUG_INFO_DWARF_TOOLCHAIN_DEFAULT=y
CONFIG_FRAME_WARN=4096
CONFIG_MAGIC_SYSRQ=y
CONFIG_DEBUG_FS=y
CONFIG_PANIC_ON_OOPS=y
CONFIG_SCHEDSTATS=y
CONFIG_RCU_CPU_STALL_TIMEOUT=60
# CONFIG_FTRACE is not set
# CONFIG_STRICT_DEVMEM is not set
```

## crypto/cryptodev/Kconfig
```kconfig
# SPDX-License-Identifier: GPL-2.0

config CRYPTODEV
	bool Cryptodev Support for Linux
```

## drivers/bst_cvsmm/Kconfig
```kconfig
config BST_CVSMM
    tristate "Support BST CVSMM"
    depends on ARM64
    depends on HAS_DMA
    help
        BST CVSMM driver is included
    default y
```

## drivers/bst_eeprom/Kconfig
```kconfig
# SPDX-License-Identifier: GPL-2.0-only
#
# bst eeprom configuration
#
config BST_EEPROM
    tristate "Support BST EEPROM"
    depends on ARM64
    help
        BST eeprom driver is included.
    default y
```

## drivers/bst_fusa_inject/Kconfig
```kconfig
# SPDX-License-Identifier: GPL-2.0-only
#
# BST Fusa Inject
#

menuconfig BST_FUSA_INJECT
	bool "BST Fusa Inject"
	default y
	help
	  This selects the function of inject cache ecc error for FUSA.

if BST_FUSA_INJECT

config FUSA_INJECT_MODULE
	tristate "BST FUSA Inject Module"
	default m
	help
	  This selects the module of inject cache ecc error for FUSA.
	  It includes some function as fallowing:
	  1. receive msg from r5 then inject error for cache ecc.

config FUSA_INJECT_BLOCK_ID
	int
	depends on BST_FUSA_INJECT
	default 116 if BST_C1200_ADAS || BST_C1200_IVI
	default 109 if BST_C1200_DB

config FUSA_INJECT_LSM_ID
	int
	depends on BST_FUSA_INJECT
	default 0 if BST_C1200_ADAS || BST_C1200_IVI
	default 0 if BST_C1200_DB

config FUSA_INJECT_PID
	int
	default 20 if BST_C1200_ADAS
	default 17 if BST_C1200_IVI
	default 32 if BST_C1200_DB

endif
```

## drivers/bst_gtc/Kconfig
```kconfig
config BST_GTC
    tristate "Support BST GTC"
    depends on ARM64
    help
        BST gtc driver is included
    default n
```

## drivers/bst_health_monitor/Kconfig
```kconfig
# SPDX-License-Identifier: GPL-2.0-only
#
# BST Health Monitor
#

menuconfig BST_HEALTH_MONITOR
	bool "BST Health Monitor"
	default y
	help
	  This selects the function of health monitor for kernel.
	  Health monitor can check the heart beat from a service task from
	  userspace and manage the heart beat from kernel to core R5.
	  And it also decides where the task should be restarted or not.

if BST_HEALTH_MONITOR

config HEALTH_MONITOR_MODULE
	tristate "BST Health Monitor Module"
	default m
	help
	  This selects the module of health monitor for kernel.
	  It includes some function as fallowing:
	  1. Sending dtc to core R5.

config HEALTH_MONITOR_PID
	int
	depends on BST_HEALTH_MONITOR
	default 22 if BST_C1200_ADAS
	default 18 if BST_C1200_IVI
	default 33 if BST_C1200_DB

config HEALTH_MONITOR_SID
	int
	depends on BST_HEALTH_MONITOR
	default 5 if BST_C1200_ADAS || BST_C1200_IVI
	default 5 if BST_C1200_DB

config HEALTH_MONITOR_FID
	int
	default 3 if BST_C1200_ADAS 
	default 3 if BST_C1200_IVI
	default 1 if BST_C1200_DB

endif
```

## drivers/bst_hwcv/Kconfig
```kconfig
config BST_HWCV
	tristate "BST HWCV Driver"
	depends on ARM64
	help
		Enable HWCV driver.

config BST_HWCV_PROC_FS
	bool "Enable HWCV procfs"
	select BST_HWCV_DEBUGGER
	depends on PROC_FS
	help
		Enable procfs to debug HWCV driver.

config BST_HWCV_DEBUG_FS
	bool "Enable HWCV debugfs"
	select BST_HWCV_DEBUGGER
	depends on DEBUG_FS
	help
		Enable debugfs to debug HWCV driver.

config BST_HWCV_DEBUGGER
	bool
	help
		Enable the debugger of HWCV, you can use procfs and debugfs for debugging.

config BST_HWCV_MULTI_OS
	bool "Enable HWCV multi os support"
	help
		Enable multi os support.
```

## drivers/bst_ipc/Kconfig
```kconfig
config BST_IPC
	bool "Support BST IPC"
	depends on ARM64
	help
	  BST IPC driver is included
	default y
config BST_IPC_STRESS
	tristate "Support BST IPC STRESS"
	depends on ARM64
	help
	  BST IPC driver is included
	default y
	
```

## drivers/bst_ipc_msgbx/Kconfig
```kconfig
menuconfig BST_IPC_MSGBX
	bool "Support BST IPC Msgbox"
	depends on ARM64
	help
	  BST IPC Msgbox driver is included
	default n

if BST_IPC_MSGBX
config MSGBOX_DEBUG
	bool "Support BST IPC Msgbox Debug"
	depends on BST_IPC_MSGBX
	select IPC_LOG_SUPPORT
	default n

config MSGBOX_DEBUG_FS
	bool "Support BST IPC Msgbox Debug_fs"
	depends on BST_IPC_MSGBX
	default y

config MSGBOX_DEBUG_TEST
	bool "Support BST IPC Msgbox Debug Test"
	depends on BST_IPC_MSGBX
	default n

config MSGBOX_TEST_MODULE
	tristate "Support BST IPC Msgbox Test Module"
	depends on MSGBOX_DEBUG_TEST
	default m

config TRANS_LAYER_RECV_USE_INT
	bool "BST IPC Msgbox receive mode"
	depends on BST_IPC_MSGBX
	default y

config MSGBOX_CHANNEL_COUNT_BITS
	int "BST IPC Msgbox Channel count"
	depends on BST_IPC_MSGBX
	default 3 if BST_C1200_ADAS || BST_C1200_IVI || ARCH_BSTA2000
	default 1 if BST_C1200_DB

config MSGBOX_DEF_FLT_ST_ADDR
	int "BST IPC Msgbox Channel count"
	depends on BST_IPC_MSGBX
	default 8 if ARCH_BSTC1200
	default 0 if ARCH_BSTA2000

config MSGBOX_DEF_FLT_END_ADDR
	int "BST IPC Msgbox Channel count"
	depends on BST_IPC_MSGBX
	default 63 if BST_C1200_ADAS || BST_C1200_IVI || ARCH_BSTA2000
	default 15 if BST_C1200_DB

config MSGBOX_MISCDEV_MOD
	bool "Compile Msgbox Miscdev Independly"
	depends on BST_IPC_MSGBX
	default y

config IPC_LOG_SUPPORT
	bool
	depends on BST_IPC_MSGBX

config IPC_STATE_MGT_ENABLE
	bool "Support IPC State Management"
	depends on BST_IPC_MSGBX
	default y

config MSGBOX_SLT_OVERFLOW_MSG_BUF_SIZE
	int "BST IPC Msgbox slt reply overflow msg buf size"
	depends on BST_IPC_MSGBX && (C1200_SLT || C1200_MASS)
	default 8 if BST_C1200_ADAS || BST_C1200_IVI
	default 2 if BST_C1200_DB
endif
```

## drivers/bst_lwnn/Kconfig
```kconfig
config BST_LWNN
    tristate "Support BST LWNN"
    depends on ARM64
    depends on HAS_DMA
    select BST_CVSMM
    help
        BST LWNN driver is included
    default m
```

## drivers/bst_sqbuffer/Kconfig
```kconfig
config BST_SQBUFFER
	tristate "Support BST sqbuffer"
	depends on ARM64
	depends on !C1200_SLT && !C1200_MASS
	default y
	help
	  BST sqbuffer is a circular queue based on the producer-consumer model,
	  used for sharing data between multiple cores.

	  To compile as a module, choose M here: the module will be called
	  bst_sqbuffer.
```

## drivers/bst_stl/Kconfig
```kconfig
config BST_STL
    tristate "Support for stl drivers"
    depends on ARM64
    help
        BST stl test interface
    default n
```

## drivers/bst_timer/Kconfig
```kconfig
config BST_LSP_TIMER
	tristate "BST LSP TIMER support"
	default y
	help
	  Enable support for Black Sesame Team lsp timer.
```

## drivers/bstn/Kconfig
```kconfig
config BSTN
    tristate "Support BSTN IP"
    depends on ARM64
    depends on HAS_DMA
    depends on BST_IPC
    depends on BST_IPC_MSGBX
    help
        BSTN Core driver is included
    default m
```

## drivers/crypto/bst_crypto/Kconfig
```kconfig
config CRYPTO_DEV_HFE
	bool "Enable support for hash on bst devices"
	depends on CRYPTO_DEV_BST
	select CRYPTO_MD5
	select CRYPTO_SHA1
	select CRYPTO_SHA256
	select CRYPTO_SHA512
	help
	  Say y to enable support for hash algorithms.

config CRYPTO_DEV_SKE
	bool "Enable support for Symmetric Key Engine on bst devices"
	depends on CRYPTO_DEV_BST
	select CRYPTO_SM4
	select CRYPTO_AES
	help
	  Say y to enable support for hash symmetric key algorithms.

config CRYPTO_DEV_PKE
	bool "Enable support for Symmetric Key Engine on bst devices"
	depends on CRYPTO_DEV_BST
	select CRYPTO_RSA
	select CRYPTO_SM2
	help
	  Say y to enable support for hash symmetric key algorithms.
```
