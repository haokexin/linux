## Documentation/devicetree/bindings/arm/bst/bst,bst-msgbox.txt
```
Black Sesame Technologies Msgbox
================================

THe Black Sesame Technologies Msgbox provides msgbox for the communication between cores.

Required Properties:

- compatible: Should be:
	- "bst,bst-msgbox"
- spi-irq-num: 0 or 4
- filter-num: 2 or 8

Example:
bst-msgbox: msgbox@0x32a00000 {
	compatible = "bst,bst-msgbox";
	reg =   <0x0 0x32a00000 0 0x100000>;
	spi-irq-num = <4>;
	filter-num = <8>;
};
```

## Documentation/devicetree/bindings/arm/bst/bst,c1200-csi2-rx.txt
```
Black Sesame Technologies Msgbox
================================

THe Black Sesame Technologies Msgbox provides msgbox for the communication between cores.

Required Properties:

- compatible: Should be:
	- "bst,c1200-csi2-rx"
- id: 0 1 or 2
- data-lanes : 1-4
- lane-speed : 800-4500 for DPHY, 800-3500 for CPHY

Example:
bst-msgbox: msgbox@0x32a00000 {
	compatible = "bst,c1200-csi2-rx";
	reg = <0x0 0x53000000 0x0 0x00015500>,
			<0x0 0x53015500 0x0 0x00000100>;
	data-lanes = <1 2 3 4>;
	lane-speed = <2500>;
};
```

## Documentation/devicetree/bindings/cpufreq/cpufreq-bst.yaml
```yaml
# SPDX-License-Identifier: GPL-2.0-only OR BSD-2-Clause
%YAML 1.2
---
$id: http://devicetree.org/schemas/cpufreq/cpufreq-qcom-hw.yaml#
$schema: http://devicetree.org/meta-schemas/core.yaml#

title: Black Sesame Technologies, Inc. CPUFREQ Bindings

maintainers:
  - Xuran Yang <xuran.yang@bst.ai>

description:
  CPUFREQ HW is a hardware engine used by Black Technologies SoCs
  to manage frequency in hardware. It is capable of controlling frequency
  for multiple clusters.


properties:
  compatible:
    contains:
      enum:
        - bst,cpufreq-c1200


  reg:
    minItems: 1
    maxItems: 2
    description:
      Addresses and sizes for the memory of the HW bases in
      each frequency domain. Each entry corresponds to
      a register bank for each frequency domain present.

  clocks:
    items:
      - description: Cluster0 Clock
      - description: Cluster1 Clock

  clock-names:
    items:
      - const: cluster0
      - const: cluster1

  '#freq-domain-cells':
    const: 1

required:
  - compatible
  - reg
  - clocks
  - clock-names
  - '#freq-domain-cells'

additionalProperties: false

examples:
  - |
      cpu_l0: cpu@0 {
        compatible = "arm,cortex-a78", "arm,armv8";
        device_type = "cpu";
        enable-method = "psci";
        next-level-cache = <&l2_0>;
        reg = <0x0>;
        freq-domain = <&cpufreq 0>;
      };
      cpu_b0: cpu@100 {
        compatible = "arm,cortex-a78", "arm,armv8";
        device_type = "cpu";
        enable-method = "psci";
        next-level-cache = <&l2_1>;
        reg = <0x10000>;
        freq-domain = <&cpufreq 1>;
      };

      amba_apu@0 {
        cpufreq: cpufreq@0 {
          compatible = "bst,cpufreq-c1200";
          reg = <0 0x30002000 0 0x1000>;
          clocks= <&scmi_clk GATE_LB_CPU0_MP4_CORE_CLK_EN>,
                  <&scmi_clk GATE_LB_CPU1_MP4_CORE_CLK_EN>;
          clock-names = "cluster0", "cluster1";
          #freq-domain-cells = <1>;
        };
      };
...
```

## Documentation/devicetree/bindings/pci/bst-dw-pcie-ep.yaml
```yaml
# SPDX-License-Identifier: GPL-2.0
%YAML 1.2
---
$id: http://devicetree.org/schemas/pci/bst,dw-pcie-ep.yaml#
$schema: http://devicetree.org/meta-schemas/core.yaml#

title: Black Sesame Technologies PCIe EP interface

maintainers:
  - Xuran Yang <xuran.yang@bst.ai>

description: |
  Black Sesame Technologies SOC PCIe EP controller

allOf:
  - $ref: /schemas/pci/pci-bus.yaml#

properties:
  compatible:
    anyOf:
      - {}
      - const: bst,dw-pcie-ep

  reg:
    description:
      - Data Bus Interface (DBI) registers
    minItems: 2
    maxItems: 5

  reg-names:
    minItems: 2
    maxItems: 5
    items:
      enum: [ dbi, dbi2, atu, dma, config]

  num-lanes:
    description: |
      number of lanes to use (this property should be specified unless
      the link is brought already up in firmware)
    maximum: 16

  interrupts: true

  interrupt-names: true

  num-viewport:
    $ref: /schemas/types.yaml#/definitions/uint32
    maximum: 256
    description: |
      number of view ports configured in hardware. If a platform
      does not specify it, the driver autodetects it.
    deprecated: true

additionalProperties: true

required:
  - reg
  - reg-names
  - compatible

examples:
  - |
    bus {
      #address-cells = <0x2>;
      #size-cells = <0x2>;
      pcie0_ep:pcie0_ep@400000000 {
        status = "disable";
        compatible = "bst,dw-pcie-ep";
        device_type = "pci";
        controller-id = <0>;
        chip-type = <0x1>;
        reg =	<0x4 0x00000000 0 0x00080000>,
          <0x4 0x00100000 0 0x00080000>,
          <0x5 0x80000000 0 0x00040000>,
          <0x5 0x80080000 0 0x00040000>,
          <0x0 0x40000000 0 0x80000000>;
        reg-names = "dbi", "dbi2", "atu", "dma", "addr_space";
        num-ib-windows = <16>;
        num-ob-windows = <16>;
        max-functions = /bits/ 8 <8>;
      };
```

## Documentation/devicetree/bindings/rng/bst,bst-rng.yaml
```yaml
# SPDX-License-Identifier: (GPL-2.0)
%YAML 1.2
---
$id: "http://devicetree.org/schemas/rng/bst,bst-rng.yaml#"
$schema: "http://devicetree.org/meta-schemas/core.yaml#"

title: HWRNG support for Black Sesame SOCs

maintainers:
  - Xuran Yang <xuran.yang@bst.ai>

properties:
  compatible:
    enum:
      - bst,c1200-rng

  memory-region:
    maxItems: 1

required:
  - memory-region
  - msgbx-pid

additionalProperties: false

examples:
  - |
    bst-rng@0 {
      status = "okay";
      compatible = "bst,c1200-rng";
      memory-region = <&bst_hwrng_buf_reserved>;
      msgbx-pid = <0x14>;
    };
```
