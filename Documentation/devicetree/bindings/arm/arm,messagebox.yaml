## Documentation/devicetree/bindings/arm/arm,messagebox.yaml
```yaml
# SPDX-License-Identifier: (GPL-2.0-only OR BSD-2-Clause)
%YAML 1.2
---
$id: http://devicetree.org/schemas/arm/arm,messagebox.yaml#
$schema: http://devicetree.org/meta-schemas/core.yaml#

title: Generic ARM Message Box

maintainers:
  - John Jacques <john.jacques@intel.com>

properties:
  compatible:
    items:
      - const: arm,messagebox

  reg:
    maxItems: 1

  interrupts:
    maxItems: 1

required:
  - compatible
  - reg
  - interrupts

additionalProperties: false

examples:
  - |
    vmfs@8034010000 {
        compatible = "arm,messagebox";
        reg = <0x80 0x34010000 0 0x1000>;
        interrupts = <GIC_SPI 638 IRQ_TYPE_LEVEL_HIGH>;
    };

...
```

## Documentation/devicetree/bindings/arm/intel,axxia.yaml
```yaml
# SPDX-License-Identifier: GPL-2.0
%YAML 1.2
---
$id: http://devicetree.org/schemas/arm/intel,axxia.yaml#
$schema: http://devicetree.org/meta-schemas/core.yaml#

title: Intel Axxia platforms device tree bindings

maintainers:
  - Anders Berg <anders.berg@intel.com>
  - John Jacques <john.jacques@intel.com>

properties:
  $nodename:
    const: "/"
  compatible:
    oneOf:
      - description: Intel Axxia AXM5500 (Amarillo) - up to 16 Cortex-A15
        items:
          - enum:
            - axxia,axm5500-sim  # AXM5500 Simulation Platform
            - axxia,axm5500-emu  # AXM5500 Emulation Platform
            - axxia,axm5500-amarillo  # AXM5500 Amarillo
          - const: axxia,axm5500

      - description: Intel Axxia AXM5600 (Victoria) - up to 16 Cortex-A57
        items:
          - const: axxia,axm5616  # Simulation, Emulation & Victoria

      - description: Intel Axxia AXC6700 (Waco) - up to 32 Cortex-A53
        items:
          - const: axxia,axc6732  # Simulation, Emulation & Waco

additionalProperties: true

...
```

## Documentation/devicetree/bindings/arm/intel-axxia/intel,axxia-edac-cm.yaml
```yaml
# SPDX-License-Identifier: (GPL-2.0-only OR BSD-2-Clause)
%YAML 1.2
---
$id: http://devicetree.org/schemas/arm/intel-axxia/axxia,edac-cm.yaml#
$schema: http://devicetree.org/meta-schemas/core.yaml#

title: Intel Axxia Configuration Memory Error Detection & Correction [EDAC]

maintainers:
  - John Jacques <john.jacques@intel.com>

description: |
  EDAC node to describe Configuration Memory error detection & correction
  on Intel Axxia devices. The EDAC accesses a range of registers in
  the memory controllers. System Memory error detection is interrupt
  driven (should contain the CMEM controller IRQ).

properties:
  compatible:
    items:
      - const: intel,cmmon

  reg:
    maxItems: 1

  syscon:
    $ref: /schemas/types.yaml#definitions/phandle
    description: Phandle to the system control device node.

  interrupts:
    maxItems: 1
    description: Should contain the CMEM controller IRQ.

required:
  - compatible
  - reg
  - syscon
  - interrupts

additionalProperties: true

examples:
  - |
    cm0: cm0@00080009 {
         compatible = "intel,cmmon";
         reg = <0 0x0080009 0 0x1000>;
         syscon = <&syscon>;
         interrupts = <0 233 4>;
    };

    cm1: cm1@00090009 {
         compatible = "intel,cmmon";
         reg = <0 0x0090009 0 0x1000>;
         syscon = <&syscon>;
         interrupts = <0 234 4>;
    };

...
```

## Documentation/devicetree/bindings/arm/intel-axxia/intel,axxia-edac-l2.yaml
```yaml
# SPDX-License-Identifier: (GPL-2.0-only OR BSD-2-Clause)
%YAML 1.2
---
$id: http://devicetree.org/schemas/arm/intel-axxia/intel,axxia-edac-l2.yaml#
$schema: http://devicetree.org/meta-schemas/core.yaml#

title: Intel Axxia L2 cache Error Detection & Correction [EDAC]

maintainers:
  - John Jacques <john.jacques@intel.com>

description: |
  EDAC node to describe L2 cache error detection & correction on
  Intel Axxia AXM55xx, AXM56xx and AXM67xx devices. The EDAC accesses
  ARM v7/v8 L2MERRSR_EL1 register data. ARM A15, A53 and A57 CPUs error
  detection uses polling mechanism.

properties:
  compatible:
    items:
      - enum:
        - axxia,cortex-a15-l2-cache  # for AXM55xx
        - intel,cortex-a57-l2-cache  # for AXM56xx
        - intel,cortex-a53-l2-cache  # for AXM67xx

  syscon:
    $ref: /schemas/types.yaml#definitions/phandle
    description: |
      Phandle to the SYSCON node for 55xx/56xx/67xx.

required:
  - compatible
  - syscon

additionalProperties: true

examples:
  - |
    edac_l2: edac_l2 {
             compatible = "intel,cortex-a57-l2-cache";
             syscon = <&syscon>;
    };

...
```

## Documentation/devicetree/bindings/arm/intel-axxia/intel,axxia-edac-l3.yaml
```yaml
# SPDX-License-Identifier: (GPL-2.0-only OR BSD-2-Clause)
%YAML 1.2
---
$id: http://devicetree.org/schemas/arm/intel-axxia/intel,axxia-edac-l3.yaml#
$schema: http://devicetree.org/meta-schemas/core.yaml#

title: Intel Axxia L3 cache Error Detection & Correction [EDAC]

maintainers:
  - John Jacques <john.jacques@intel.com>

description: |
  EDAC node to describe L3 cache error detection & correction on
  Intel Axxia AXM55xx, AXM56xx and AXM55xx devices. The EDAC accesses
  a range of registers in the dickens l3 controller. L3 cache error
  detection can use polling mechanism or be interrupt driven.

properties:
  compatible:
    items:
      - enum:
        - axxia,ccn504-l3-cache  # for AXM55xx
        - intel,ccn504-l3-cache  # for AXM56xx
        - intel,ccn512-l3-cache  # for AXC67xx

  reg:
    maxItems: 1
    description: |
      Should contain address of ccn first node; its range shall contain
      all ccn nodes registers (0x1000000).

  syscon:
    $ref: /schemas/types.yaml#definitions/phandle
    description: |
      Phandle to the SYSCON node.

  interrupts:
    maxItems: 1
    description: |
      If given driver uses interrupts, if not poll mechanism applies.

required:
  - compatible
  - reg
  - syscon

additionalProperties: true

examples:
  - |
    edac_l3: edac_l3 {
             compatible = "intel,ccn504-l3-cache";
             reg = <0x80 0x00000000 0 0x1000000>;
             interrupts = <0 256 4>;
             syscon = <&syscon>;
    };

    edac_l3: edac_l3 {
             compatible = "intel,ccn512-l3-cache";
             reg = <0x40 0x00000000 0 0x1000000>;
             interrupts = <0 432 4>;
             syscon = <&syscon>;
    };

...
```

## Documentation/devicetree/bindings/arm/intel-axxia/intel,axxia-edac-sm.yaml
```yaml
# SPDX-License-Identifier: (GPL-2.0-only OR BSD-2-Clause)
%YAML 1.2
---
$id: http://devicetree.org/schemas/arm/intel-axxia/intel,axxia-edac-sm.yaml#
$schema: http://devicetree.org/meta-schemas/core.yaml#

title: Intel Axxia System Memory Error Detection & Correction [EDAC]

maintainers:
  - John Jacques <john.jacques@intel.com>

description: |
  EDAC node to describe System Memory error detection & correction
  on Intel Axxia devices. The EDAC accesses a range of registers in
  the memory controllers. System Memory error detection is interrupt
  driven (should contain the SYSMEM controller IRQ).

properties:
  compatible:
    items:
      - enum:
        - axxia,smmon # for AXM55xx
        - intel,smmon # for AXM56xx and AXC67xx

  reg:
    maxItems: 2

  syscon:
    $ref: /schemas/types.yaml#definitions/phandle
    description: Phandle to the system control device node.

  interrupts:
    maxItems: 1
    description: Should contain the SYSMEM controller IRQ.

required:
  - compatible
  - reg
  - interrupts

additionalProperties: true

examples:
  - |
    sm0: sm0@00220000 {
         compatible = "intel,smmon";
         reg = <0 0x00220000 0 0x1000>;
         syscon = <&syscon>;
         interrupts = <0 238 4>;
    };

    sm1: sm1@00220000 {
         compatible = "axxia,smmon";
         reg = <0 0x000f0000 0 0x1000>,
               <0x20 0x10030000 0 0001000>;
         interrupts = <0 160 4>;
         status = "disabled";
    };

...
```

## Documentation/devicetree/bindings/arm/intel-axxia/intel,axxia-edac.yaml
```yaml
# SPDX-License-Identifier: (GPL-2.0-only OR BSD-2-Clause)
%YAML 1.2
---
$id: http://devicetree.org/schemas/arm/intel-axxia/intel,axxia-edac.yaml#
$schema: http://devicetree.org/meta-schemas/core.yaml#

title: Intel Axxia Error Detection & Correction [EDAC]

maintainers:
  - John Jacques <john.jacques@intel.com>

description: |
  EDAC node to describe detection & correction on Intel Axxia devices.
  The EDAC accesses a range of registers in the memory controllers.
  System Memory error detection is interrupt driven.

properties:
  compatible:
    items:
      - const: axxia,edac

  reg:
    maxItems: 11

  interrupts:
    maxItems: 2

  device_type:
    const: edac

required:
  - compatible
  - reg
  - interrupts
  - device_type

additionalProperties: true

examples:
  - |
    edac: edac0@0x1000 {
          compatible = "axxia,edac";
          reg = <0 0x00220000 0 0x1000>,
                <0 0x000f0000 0 0x1000>,
                <0x20 0x10030000 0 0001000>,
                <0x20 0x00200400 0 0001000>,
                <0x20 0x00210400 0 0001000>,
                <0x20 0x00220400 0 0001000>,
                <0x20 0x00230400 0 0001000>,
                <0x20 0x00240400 0 0001000>,
                <0x20 0x00250400 0 0001000>,
                <0x20 0x00260400 0 0001000>,
                <0x20 0x00270400 0 0001000>;
          interrupts = <0 160 4>,
                       <0 161 4>;
          device_type = "edac";
          status = "disabled";
    };

...
```

## Documentation/devicetree/bindings/arm/intel-axxia/intel,axxia-gpreg.yaml
```yaml
# SPDX-License-Identifier: (GPL-2.0-only OR BSD-2-Clause)
%YAML 1.2
---
$id: http://devicetree.org/schemas/arm/intel-axxia/intel,axxia-gpreg.yaml#
$schema: http://devicetree.org/meta-schemas/core.yaml#

title: GP device node for Intel Axxia FEMAC driver from AXM55xx

maintainers:
  - John Jacques <john.jacques@intel.com>

properties:
  compatible:
    items:
      - const: axxia,gpreg

  reg:
    maxItems: 1

required:
  - compatible
  - reg

additionalProperties: false

examples:
  - |
    gpreg: gpreg@2010094000  {
           compatible = "axxia,gpreg";
           reg = <0x20 0x10094000 0 0x1000>;
    };

...
```

## Documentation/devicetree/bindings/arm/intel-axxia/intel,axxia-nca.yaml
```yaml
# SPDX-License-Identifier: (GPL-2.0-only OR BSD-2-Clause)
%YAML 1.2
---
$id: http://devicetree.org/schemas/arm/intel-axxia/intel,axxia-nca.yaml#
$schema: http://devicetree.org/meta-schemas/core.yaml#

title: Intel Axxia NCA Config Ring driver for AXM55xx

maintainers:
  - John Jacques <john.jacques@intel.com>

description: |
  Bindings for Intel Axxia NCA Config Ring driver which coordinate with
  the RTE ncp driver to detect when NCA hardware is being held in reset.

properties:
  compatible:
    items:
      - const: axxia,nca

  reg:
    maxItems: 1

required:
  - compatible
  - reg

additionalProperties: false

examples:
  - |
    nca@2020100000 {
       compatible = "axxia,nca";
       reg = <0x20 0x20100000 0 0x20000>;
    };

...
```

## Documentation/devicetree/bindings/arm/intel-axxia/intel,axxia-platformperf.yaml
```yaml
# SPDX-License-Identifier: (GPL-2.0-only OR BSD-2-Clause)
%YAML 1.2
---
$id: http://devicetree.org/schemas/arm/intel-axxia/intel,axxia-platformperf.yaml#
$schema: http://devicetree.org/meta-schemas/core.yaml#

title: Intel Axxia Platform Perf for AXM55xx

maintainers:
  - John Jacques <john.jacques@intel.com>

description: |
  Intel Axxia hardware performance counter support for perf events
  on ARM cores (AXM55xx).

properties:
  compatible:
    items:
      - const: axxia,axm-platformperf

required:
  - compatible

additionalProperties: true

examples:
  - |
    perf_platform: perf_platform {
        compatible = "axxia,axm-platformperf";
    };

...
```

## Documentation/devicetree/bindings/arm/intel-axxia/intel,axxia-syscon.yaml
```yaml
# SPDX-License-Identifier: (GPL-2.0-only OR BSD-2-Clause)
%YAML 1.2
---
$id: http://devicetree.org/schemas/arm/intel-axxia/intel,axxia-syscon.yaml#
$schema: http://devicetree.org/meta-schemas/core.yaml#

title: Intel Axxia System Controller Registers for AXM56xx and AXC67xx

maintainers:
  - John Jacques <john.jacques@intel.com>

properties:
  compatible:
    items:
      - const: axxia,axxia-syscon
      - const: syscon

  reg:
    maxItems: 1

required:
  - compatible
  - reg

additionalProperties: false

examples:
  - |
    syscon: syscon@8002000000 {
            compatible = "axxia,axxia-syscon", "syscon";
            reg = <0x80 0x02c00000 0 0x40000>;
    };

...
```

## Documentation/devicetree/bindings/dma/intel,axxia-dma.yaml
```yaml
# SPDX-License-Identifier: (GPL-2.0-only OR BSD-2-Clause)
%YAML 1.2
---
$id: http://devicetree.org/schemas/dma/intel,axxia-dma.yaml#
$schema: http://devicetree.org/meta-schemas/core.yaml#

title: Intel Axxia General Purpose DMA controller

maintainers:
  - John Jacques <john.jacques@intel.com>

description: |
  Bindings for the Intel Axxia General Purpose DMA controller found
  on AXM55xx, AXM56xx and AXC67xx devices.

properties:
  compatible:
    items:
      - const: axxia,dma32
      - const: axxia,dma31

  dma-coherent: true

  "#dma-cells":
    const: 1
    description: |
      The length of the DMA specifier, must be <1>. This one cell
      in dmas property of a client device represents the channel number.

  reg:
    maxItems: 1

  interrupts:
    maxItems: 2
    description: |
      Should contain one DMA interrupt per-channel. Intel Axxia DMA
      controller has 2 channels in total.

patternProperties:
  "^channel[0-2]$":
    type: object
    description: |
      Sub-node for each DMA channel on the Axxia controller. Should
      define the interrupts for the channel.

    properties:
      interrupts:
        maxItems: 1

    additionalProperties: false
    required:
      - interrupts

required:
  - compatible
  - dma-coherent
  - reg
  - interrupts
  - "#dma-cells"

additionalProperties: true

examples:
  - |
    gpdma0: gpdma@8005020000 {
            compatible = "axxia,dma32";
            dma-coherent;
            reg = <0x80 0x05020000 0 0x10000>;
            interrupts = <GIC_SPI 44 IRQ_TYPE_LEVEL_HIGH>,
                         <GIC_SPI 45 IRQ_TYPE_LEVEL_HIGH>;
            #dma-cells = <1>;
            channel0 {
                interrupts = <GIC_SPI 46 IRQ_TYPE_LEVEL_HIGH>;
            };

            channel1 {
                interrupts = <GIC_SPI 47 IRQ_TYPE_LEVEL_HIGH>;
            };
    };

...
```

## Documentation/devicetree/bindings/fpga/sysfpga.yaml
```yaml
# SPDX-License-Identifier: (GPL-2.0-only OR BSD-2-Clause)
%YAML 1.2
---
$id: http://devicetree.org/schemas/fpga/sysfpga.yaml#
$schema: http://devicetree.org/meta-schemas/core.yaml#

title: System FPGA Device Tree Binding

maintainers:
  - John Jacques <john.jacques@intel.com>

properties:
  compatible:
    items:
      - const: sysfpga

  reg:
    maxItems: 1
    default: 0x40

required:
  - compatible
  - reg

examples:
  - |
    sysfpga@40 {
            compatible = "sysfpga";
            reg = <0x40>;
    };

...
```

## Documentation/devicetree/bindings/gpio/intel,axxia-ssp-gpio.yaml
```yaml
# SPDX-License-Identifier: (GPL-2.0-only OR BSD-2-Clause)
%YAML 1.2
---
$id: http://devicetree.org/schemas/gpio/intel,axxia-ssp-gpio.yaml#
$schema: http://devicetree.org/meta-schemas/core.yaml#

title: Intel Axxia GPIO interface for SSP chip select pins

maintainers:
  - John Jacques <john.jacques@intel.com>

description: |
  Intel Axxia GPIO interface for SSP chip select pins for AXM55xx.

properties:
  compatible:
    items:
      - const: axxia,ssp-gpio

  "#gpio-cells":
    const: 2

  gpio-controller: true

  reg:
    maxItems: 1

required:
  - compatible
  - "#gpio-cells"
  - igpio-controller
  - reg

additionalProperties: true

examples:
  - |
    spics: sspgpio@2010088030 {
           #gpio-cells = <2>;
           compatible = "axxia,ssp-gpio";
           gpio-controller;
           reg = <0x20 0x10088000 0x00 0x1000>;
    };

...
```
