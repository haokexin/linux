## Documentation/devicetree/bindings/hwrng/intel,axxia-rng.yaml
```yaml
# SPDX-License-Identifier: (GPL-2.0-only OR BSD-2-Clause)
%YAML 1.2
---
$id: http://devicetree.org/schemas/bindings/hwrng/intel,axxia-rng.yaml#
$schema: http://devicetree.org/meta-schemas/core.yaml#

title: Intel Axxia TRNG HWRNG Driver Module

maintainers:
  - John Jacques <john.jacques@intel.com>

description: |
  Intel Axxia TRNG node for random number generation which provides
  HW Random number generation using AXXIA HW block. When enabled in
  the device tree, /dev/hwrng device is available and random numbers
  can be read from there.

properties:
  compatible:
    items:
      - const: axxia,trng

  reg:
    maxItems: 1
    description: Offset and length of the register set for the module.

  interrupts:
    maxItems: 1

required:
  - compatible
  - reg
  - interrupts

additionalProperties: true

examples:
  - |
    trng: trng@8031060000 {
          compatible = "axxia,trng";
          reg = <0x80 0x31060000 0x20000>;
          interrupts = <GIC_SPI 4 IRQ_TYPE_LEVEL_HIGH>;
    };

...
```

## Documentation/devicetree/bindings/i2c/intel,axxia-i2c.yaml
```yaml
# SPDX-License-Identifier: (GPL-2.0-only OR BSD-2-Clause)
%YAML 1.2
---
$id: http://devicetree.org/schemas/i2c/intel,axxia-i2c.yaml#
$schema: http://devicetree.org/meta-schemas/core.yaml#

title: INTEL Axxia I2C Interrupt Controller

maintainers:
  - John Jacques <john.jacques@intel.com>

description: |
  This implements I2C master functionality using the Intel Axxia API2
  controller.

properties:
  compatible:
    items:
      - const: axxia,api2c

  "#address-cells":
    const: 1

  "#size-cells":
    const: 0

  reg:
    maxItems: 1
    description: Offset and length of the register set for the device.

  interrupts:
    maxItems: 1
    description: Should contain the SYSMEM controller IRQ.

  clocks:
    minItems: 1
    description: |
      I2C controller reference clock source. Must contain an entry for
      each name in clock-names.

  clock-names:
    items:
      - const: i2c

  clock-frequency:
    default: 400000
    description: |
      Desired I2C bus clock frequency in Hz. If not specified, the
      default 100 kHz frequency will be used. As only Normal and Fast
      modes are supported, possible values are 100000 and 400000.

required:
  - compatible
  - "#address-cells"
  - "#size-cells"
  - reg
  - interrupts
  - clocks
  - clock-names

additionalProperties: true

examples:
  - |
    i2c0: i2c@2010084000 {
          compatible = "axxia,api2c";
          #address-cells = <1>;
          #size-cells = <0>;
          reg = <0x20 0x10084000 0x00 0x1000>;
          interrupts = <0 19 4>;
          clocks = <&clk_per>;
          clock-names = "i2c";
          clock-frequency = <400000>;
    };

...
```

## Documentation/devicetree/bindings/misc/intel,axxia-mtc.yaml
```yaml
# SPDX-License-Identifier: (GPL-2.0-only OR BSD-2-Clause)
%YAML 1.2
---
$id: http://devicetree.org/schemas/bindings/misc/intel,axxia-mtc.yaml#
$schema: http://devicetree.org/meta-schemas/core.yaml#

title: Intel Axxia Master Test Controller (MTC)

maintainers:
  - John Jacques <john.jacques@intel.com>

description: |
  Intel Axxia Master Test Controller (MTC) is a test generator that
  is fully compliant with IEEE 1149.1 and can run JTAG test sequences
  on external devices.

properties:
  compatible:
    items:
      - const: axxia,mtc

  reg:
    maxItems: 1
    description: |
      Address and length of the register set for the device registers.

  interrupts:
    maxItems: 1

required:
  - compatible
  - reg
  - interrupts

additionalProperties: true

examples:
  - |
    mtc: mtc@8080210000 {
         compatible = "axxia,mtc";
         reg = <0x80 0x80210000 0x10000>;
         interrupts = <GIC_SPI 28 IRQ_TYPE_LEVEL_HIGH>;
};

...
```

## Documentation/devicetree/bindings/net/intel,axxia-femac.yaml
```yaml
# SPDX-License-Identifier: (GPL-2.0-only OR BSD-2-Clause)
%YAML 1.2
---
$id: http://devicetree.org/schemas/bindings/net/intel,axxia-femac.yaml#
$schema: http://devicetree.org/meta-schemas/core.yaml#

title: Intel Axxia Fast Ethernet Controller (FEMAC)

maintainers:
  - John Jacques <john.jacques@intel.com>

description: |
  Bindings for the Intel Axxia Fast Ethernet controller found on the
  Axxia 5500 families of devices.

properties:
  compatible:
    items:
      - const: axxia,acp-femac

  device_type:
    const: network

  reg:
    items:
      - description: RX register
      - description: TX register
      - description: DMA register

  interrupts:
    items:
      - description: RX irq
      - description: TX irq
      - description: DMA irq

  mac-address:
    $ref: ethernet-controller.yaml#/properties/mac-address

  local-mac-address:
    $ref: ethernet-controller.yaml#/properties/local-mac-address

required:
  - compatible
  - device_type
  - reg
  - interrupts

additionalProperties: true

examples:
  - |
    femac: femac@0x2010120000 {
           compatible = "axxia,acp-femac";
           device_type = "network";
           reg = <0x20 0x10120000 0 0x1000>,
                 <0x20 0x10121000 0 0x1000>,
                 <0x20 0x10122000 0 0x1000>;
           interrupts = <0 2 4>,
                        <0 3 4>,
                        <0 4 4>;
           mac-address = [00 00 00 00 00 00];
    };

...
```

## Documentation/devicetree/bindings/net/intel,axxia-mdio.yaml
```yaml
# SPDX-License-Identifier: (GPL-2.0-only OR BSD-2-Clause)
%YAML 1.2
---
$id: http://devicetree.org/schemas/net/intel,axxia-mdio.yaml#
$schema: http://devicetree.org/meta-schemas/core.yaml#

title: Intel Axxia Fast Ethernet MDIO Controller interface

maintainers:
  - John Jacques <john.jacques@intel.com>

description: Provides access to the Axxia MDIO bus.

properties:
  compatible:
    oneOf:
      - const: axxia,axxia-mdio1
      - items:
        - const: axxia,axm-mdio
        - const: axxia,axxia-mdio0

  "#address-cells":
    const: 1

  "#size-cells":
    const: 0

  reg:
    maxItems: 1

  axxia,mdio-clk-offset:
    $ref: /schemas/types.yaml#/definitions/uint32
    description: |
      Set value used to offset the MDIO output signal. A value of N
      means the MDIO output signal is held for (N + 1) clk_per units
      long. (optional)

  axxia,mdio-clk-period:
    $ref: /schemas/types.yaml#/definitions/uint32
    description: |
      Set value used to offset the MDC signal. A value of N  means the
      MDC signal is 2 x (N + 1) clk_per units long. (optional)

  max-speed:
    maxItems: 1

required:
  - compatible
  - "#address-cells"
  - "#size-cells"
  - reg

additionalProperties: true

examples:
  - |
    mdio0: mdio@8080260000 {
           compatible = "axxia,axm-mdio", "axxia,axxia-mdio0";
           #address-cells = <1>;
           #size-cells = <0>;
           reg = <0x80 0x80260000 0 0x1000>;
    };

...
```

## Documentation/devicetree/bindings/net/intel,axxia-nemac.yaml
```yaml
# SPDX-License-Identifier: (GPL-2.0-only OR BSD-2-Clause)
%YAML 1.2
---
$id: http://devicetree.org/schemas/net/intel,axxia-nemac.yaml#
$schema: http://devicetree.org/meta-schemas/core.yaml#

title: Intel Axxia Gigabit Ethernet Controller (NEMAC)

maintainers:
  - John Jacques <john.jacques@intel.com>

description: |
  Bindings for the Intel Axxia NEMAC gigabit Ethernet controller
  found on the Axxia AXM56xx and AXC67xx families of devices.

properties:
  compatible:
    items:
      - const: intel,nemac

  device_type:
    const: network

  reg:
    maxItems: 1

  interrupts:
    maxItems: 2

  dma-coherent:
    description: Present if DMA operations are coherent.

  mac-address:
    $ref: ethernet-controller.yaml#/properties/mac-address

required:
  - compatible
  - device_type
  - reg
  - interrupts

additionalProperties: true

examples:
  - |
    nemac: ethernet@8080240000 {
           compatible = "intel,nemac";
           device_type = "network";
           reg = <0x80 0x80240000 0 0x10000>;
           interrupts = <GIC_SPI 0 IRQ_TYPE_LEVEL_HIGH>,
                        <GIC_SPI 1 IRQ_TYPE_LEVEL_HIGH>;
           dma-coherent;
           mac-address = [00 00 00 00 00 00];
    };

...
```

## Documentation/devicetree/bindings/pci/intel,axxia-pcie-dw.yaml
```yaml
# SPDX-License-Identifier: (GPL-2.0-only OR BSD-2-Clause)
%YAML 1.2
---
$id: http://devicetree.org/schemas/bindings/pci/intel,axxia-pcie-dw.yaml#
$schema: http://devicetree.org/meta-schemas/core.yaml#

title: Intel Axxia PCIe DesignWare controller

maintainers:
  - John Jacques <john.jacques@intel.com>

description: |
  Bindings for the Intel Axxia PCIe DesignWare controller found on the
  Axxia AXM56xx and AXC67xx families of devices. There are three PEI
  controllers on Axxia X9/AXM56xx and XLF/AXC67xx. Only RootComplex
  mode is supported.

properties:
  compatible:
    items:
      - const: axxia,axxia-pcie

  device_type:
    const: pci

  "#interrupt-cells":
    const: 1

  "#address-cells":
    const: 3

  "#size-cells":
    const: 2

  reg:
    minItems: 1
    description: |
      Should contain the DBI, AXI GPREG and CC GPREG address space.

  reg-names:
    items:
      -const: dbi
      -const: axi_gpreg
      -const: cc_gpreg

  num-lanes:
    maxItems: 1
    description: Number of lanes to use.

  control-value:
    maxItems: 1

  ranges:
    maxItems: 1
    description: |
      Ranges for the PCI config, outbound memory and I/O regions.

  interrupt-map-mask:
    maxItems: 1

  interrupt-map:
    maxItems: 4

  interrupts:
    minItems: 2

required:
  - compatible
  - device_type
  - reg
  - reg-names
  - "#interrupt-cells"
  - "#address-cells"
  - "#size-cells"
  - num-lanes
  - control-value
  - ranges
  - interrupt-map-mask
  - interrupt-map
  - interrupts

additionalProperties: true

examples:
  - |
    pci0: pcie@c000000000 {
          compatible = "axxia,axxia-pcie";
          device_type = "pci";
          reg = <0xa0 0x02000000 0x00100000   /* dbi */
                 0xa0 0x03000000 0x00008000   /* AXI gpreg */
                 0xa0 0x03008000 0x00008000>; /* CC gpreg */
          reg-names = "dbi", "axi_gpreg", "cc_gpreg";
          #interrupt-cells = <1>;
          #address-cells = <3>;
          #size-cells = <2>;
          num-lanes = <1>;
          control-value = <0>;
          ranges = <0x00000000 0x000000c0 0x40000000
                    0xc0 0x40000000
                    0x00 0x10000000         /* config space */
                    0x03000000 0x00000000 0xa0000000
                    0xc0 0x00000000
                    0x00 0x40000000>;       /* outbound mem */
          interrupt-map-mask = <0 0 0 7>;
          interrupt-map = <0 0 0 1 &gic 0 93 4>,
                          <0 0 0 2 &gic 0 93 4>,
                          <0 0 0 3 &gic 0 93 4>,
                          <0 0 0 4 &gic 0 93 4>;
          interrupts = <GIC_SPI 93 IRQ_TYPE_LEVEL_HIGH>,
                       <GIC_SPI 96 IRQ_TYPE_LEVEL_HIGH>;
    };

...
```

## Documentation/devicetree/bindings/pci/intel,axxia-pcie.yaml
```yaml
# SPDX-License-Identifier: (GPL-2.0-only OR BSD-2-Clause)
%YAML 1.2
---
$id: http://devicetree.org/schemas/bindings/pci/intel,axxia-pcie.yaml#
$schema: http://devicetree.org/meta-schemas/core.yaml#

title: Intel Axxia PCIe controller

maintainers:
  - John Jacques <john.jacques@intel.com>

description: |
  Bindings for the Intel Axxia PCIe controller found on the Axxia
  AXM55xx family of devices. There are two PEI controllers on
  Axxia X7/AXM55xx. Only RootComplex mode is supported.

properties:
  compatible:
    items:
      - const: axxia,plb-pciex

  device_type:
    const: pci

  "#interrupt-cells":
    const: 1

  "#address-cells":
    const: 3

  "#size-cells":
    const: 2

  reg:
    maxItems: 1
    description: Config space access MPAGE7 registers.

  ranges:
    maxItems: 1
    description: |
      Contains outbound ranges: the PCI address (3 cells), CPU (PLB)
      address (2 cells) and size (2 cells).

  dma-ranges:
    maxItems: 1
    description: |
      Contains inbound ranges: the PCI address (3 cells), CPU (PLB)
      address (2 cells) and size (2 cells).

  interrupts:
    minItems: 2

  port:
    maxItems: 1

required:
  - compatible
  - device_type
  - "#interrupt-cells"
  - "#address-cells"
  - "#size-cells"
  - reg
  - ranges
  - dma-ranges
  - interrupts
  - port

additionalProperties: true

examples:
  - |
    pcie1: pcie@0x3080000000 {
           compatible = "axxia,plb-pciex";
           device_type = "pci";
           #interrupt-cells = <1>;
           #size-cells = <2>;
           #address-cells = <3>;
           /* config space access MPAGE7 registers*/
           reg = <0x30 0xb8000000 0x0 0x01000000
                  0x20 0x20130000 0x0 0x00008000 >;
           /* Outbound ranges */
           /* < <3-cell PCI addr>
           *<2-cell CPU (PLB) addr> <2-cell size> >
           */
           ranges = <0x03000000 0x00000000 0xc0000000
                     0x30 0x80000000
                     0x00 0x20000000>;
           /* Inbound ranges */
           /* < <3-cell PCI addr>
           *<2-cell CPU addr> <2-cell size> >
           */
           dma-ranges = <0x03000000 0x00000000 0x00000000
                         0x00 0x00000000
                         0x00 0x40000000>;
           interrupts = <0 70 4>,
                        <0 72 4>;
           port = <1>;
    };

...
```

## Documentation/devicetree/bindings/perf/arm-ccn-pmu.yaml
```yaml
# SPDX-License-Identifier: (GPL-2.0-only OR BSD-2-Clause)
%YAML 1.2
---
$id: http://devicetree.org/schemas/perf/arm-ccn-pmu.yaml#
$schema: http://devicetree.org/meta-schemas/core.yaml#

title: ARM CCN PMU (Performance Monitoring Unit) modules

maintainers:
  - John Jacques <john.jacques@intel.com>

description: |
  Node bindings for ARM CCN (Cache Coherent Network) PMU (Performance
  Monitor Unit) modules.

properties:
  compatible:
    items:
      - enum:
        - arm,ccn-502-pmu
        - arm,ccn-502-l3
        - arm,ccn-504-pmu
        - arm,ccn-504-l3
        - arm,ccn-508-pmu
        - arm,ccn-508-l3
        - arm,ccn-512-pmu
        - arm,ccn-512-l3

  reg:
    maxItems: 1
    description: |
      CCN_MN reg to validate the regions.

  syscon:
    $ref: /schemas/types.yaml#definitions/phandle
    description: |
      Phandle to the SYSCON node for l3 PMU subnode (L3 cache controller).

required:
  - compatible
  - reg

additionalProperties: true

examples:
  - |
    arm_ccn_pmu: pmu@0 {
                 compatible = "arm,ccn-512-pmu";
                 reg = <0x0 0x1000000>;
    };

    arm_ccn_l3: l3@0 {
                compatible = "arm,ccn-512-l3";
                reg = <0x0 0x1000000>;
                syscon = <&syscon>;
    };

...
```

## Documentation/devicetree/bindings/perf/arm-ccn.yaml
```yaml
# SPDX-License-Identifier: (GPL-2.0-only OR BSD-2-Clause)
%YAML 1.2
---
$id: http://devicetree.org/schemas/perf/arm-ccn.yaml#
$schema: http://devicetree.org/meta-schemas/core.yaml#

title: ARM CCN (Cache Coherent Network)

maintainers:
  - Robin Murphy <robin.murphy@arm.com>

properties:
  compatible:
    items:
      - enum:
        - arm,ccn-502
        - arm,ccn-504
        - arm,ccn-508
        - arm,ccn-512

  reg:
    maxItems: 1
    description: |
      Physical address and size (16MB) of the configuration registers block.

  interrupts:
    maxItems: 1
    description: Single interrupt generated by the control block.

required:
  - compatible
  - reg
  - interrupts

additionalProperties: true

examples:
  - |
    ccn@2000000000 {
      compatible = "arm,ccn-504";
      reg = <0x20 0x00000000 0 0x1000000>;
      interrupts = <0 181 4>;
    };

...
```
