## arch/powerpc/kvm/Kconfig
```kconfig
#
# KVM configuration
#

source "virt/kvm/Kconfig"

menuconfig VIRTUALIZATION
	bool "Virtualization"
	---help---
	  Say Y here to get to see options for using your Linux host to run
	  other operating systems inside virtual machines (guests).
	  This option alone does not add any kernel code.

	  If you say N, all options in this submenu will be skipped and
	  disabled.

if VIRTUALIZATION

config PARAVIRT
        bool "Enable paravirtualization code"
        default y
        help
          This changes the kernel so it can modify itself when it is run
          under a hypervisor, potentially improving performance significantly
          over full virtualization.  However, when run without a hypervisor
          the kernel is theoretically slower and slightly larger.

          CONFIG_PARAVIRT assume a E500 like core.

config PARAVIRT_PTE
        bool "Enable 64 Bit PTE to support VMMU"
        default n
        help
          CONFIG_PARAVIRT will use 64 bit PTE for VMMU.

config PARAVIRT_CLOCK
        bool
        default n

config PARAVIRT_DEBUG
       bool "paravirt-ops debugging"
       depends on PARAVIRT && DEBUG_KERNEL
       help
         Enable to debug paravirt_ops internals.  Specifically, BUG if
         a paravirt_op is missing when it is called.

config KVM
	bool
	select PREEMPT_NOTIFIERS
	select ANON_INODES
	select KVM_MMIO

config KVM_BOOK3S_64_HANDLER
	bool

config KVM_BOOK3S_64
	tristate "KVM support for PowerPC book3s_64 processors"
	depends on EXPERIMENTAL && PPC64
	select KVM
	select KVM_BOOK3S_64_HANDLER
	---help---
	  Support running unmodified book3s_64 and book3s_32 guest kernels
	  in virtual machines on book3s_64 host processors.

	  This module provides access to the hardware capabilities through
	  a character device node named /dev/kvm.

	  If unsure, say N.

config KVM_440
	bool "KVM support for PowerPC 440 processors"
	depends on EXPERIMENTAL && 44x
	select KVM
	---help---
	  Support running unmodified 440 guest kernels in virtual machines on
	  440 host processors.

	  This module provides access to the hardware capabilities through
	  a character device node named /dev/kvm.

	  If unsure, say N.

config KVM_EXIT_TIMING
	bool "Detailed exit timing"
	depends on KVM_440 || KVM_E500
	---help---
	  Calculate elapsed time for every exit/enter cycle. A per-vcpu
	  report is available in debugfs kvm/vm#_vcpu#_timing.
	  The overhead is relatively small, however it is not recommended for
	  production environments.

	  If unsure, say N.

config KVM_E500
	bool "KVM support for PowerPC E500 processors"
	depends on EXPERIMENTAL && E500
	select KVM
	---help---
	  Support running unmodified E500 guest kernels in virtual machines on
	  E500 host processors.

	  This module provides access to the hardware capabilities through
	  a character device node named /dev/kvm.

	  If unsure, say N.

source drivers/vhost/Kconfig
source drivers/virtio/Kconfig

endif # VIRTUALIZATION
```

## drivers/firmware/octeontx2/Kconfig
```kconfig
# SPDX-License-Identifier: GPL-2.0
#
# Marvell Utility Bus for firmware
#

menuconfig MARVELL_UB
	bool "Marvell Utility Bus"
	default n
	depends on ARM64 && SYSFS
	help
	  Marvell Utility Bus provides set of drivers allowing communication
	  with various services provided by firmware for OcteonTX2
	  based platforms.
	  These drivers are useful only for Marvell CN9X and CN10X SoCs.
	  If unsure, say N here.

if MARVELL_UB

config MARVELL_UB_GEN_DRIVER
	tristate "Generic driver for OcteonTX2 & CN10K platforms"
	default y
	depends on MARVELL_UB && HAVE_ARM_SMCCC
	help
	  The generic driver provides a generic implementation of
	  platform detection and firmware services.
	  By default the drvier handles CN9X and CN10X platforms.
	  If unsure, say Y here.

config MARVELL_CN10K_MAC_MGMT
	tristate "CN10K MAC management interface"
	default n
	depends on HAVE_ARM_SMCCC
	select MARVELL_UB_GEN_DRIVER
	help
	  The module provides an interface to change MAC addresses assigned
	  to the network devices.
	  Driver is supported only for CN10K platform.
	  If unsure, say N here.

config MARVELL_SFP_INFO
	bool "Marvell SFP info sysfs interface"
	depends on HAVE_ARM_SMCCC
	select MARVELL_UB_GEN_DRIVER
	default n
	help
	  Enable support for sysfs entries to dump SFP module information
	  in similar way as the 'ethtool -m <etxX>' command.
	  The driver handles both t9x and cn10k platforms.
	  If unsure, say N here.

config MARVELL_CN10K_RPRAM
	tristate "Octeontx RPRAM configuration interface"
	depends on HAVE_ARM_SMCCC
	select MARVELL_UB_GEN_DRIVER
	default n
	help
	  The module enables configuration interface for the persistent data
	  memory region. The interface allows to control the size of the region.
	  The new value is used after platform reboot.
	  Only Octeon 10x platform are supported by this module.
	  If unsure, say N here.

endif # MARVELL_UB
```

## drivers/lsi/Kconfig
```kconfig
menu "LSI Drivers (APP3, APP3K, and ACP)"

config LSI_NAND
	bool "NAND Driver for LSI's APP and ACP"
	depends on ACP
	select MTD_NAND
	help
		Add NAND support to LSI's APP/ACP boards.

config LSI_UBOOTENV
	bool "U-Boot Environment Access for LSI's APP and ACP"
	depends on ( ACP && LSI_NAND && CRC32 )
	help
		Add U-Boot environment access on LSI's APP/ACP boards.

config SERIAL_ACP
	bool "LSI's Serial Driver for the ACP"
	select SERIAL_CORE
	help
	  Handles the serial ports (there are two) on LSI's ACP board
	  and the simulated serial port provided by ISS.

config SERIAL_ACP_CONSOLE
	bool "Console on the ACP serial port"
	depends on SERIAL_ACP=y
	select SERIAL_CORE_CONSOLE
	help
	  If you say Y here, it will be possible to use a serial port as the
	  system console (the system console is the device which receives all
	  kernel messages and warnings and which allows logins in single user
	  mode). This could be useful if some terminal or printer is connected
	  to that serial port.

	  Even if you say Y here, the currently visible virtual console
	  (/dev/tty0) will still be used as the system console by default, but
	  you can alter that using a kernel command line option such as
	  "console=ttyS1". (Try "man bootparam" or see the documentation of
	  your boot loader (grub or lilo or loadlin) about how to pass options
	  to the kernel at boot time.)

	  If you don't have a VGA card installed and you say Y here, the
	  kernel will automatically use the first serial line, /dev/ttyS0, as
	  system console.

	  You can set that using a kernel command line option such as
	  "console=uart8250,io,0x3f8,9600n8"
	  "console=uart8250,mmio,0xff5e0000,115200n8".
	  and it will switch to normal serial console when the corresponding
	  port is ready.
	  "earlycon=uart8250,io,0x3f8,9600n8"
	  "earlycon=uart8250,mmio,0xff5e0000,115200n8".
	  it will not only setup early console.

	  If unsure, say N.

config SERIAL_ACP_CONSOLE_POLL
	bool "Don't use interrupts in the ACP serial driver"
	depends on SERIAL_ACP_CONSOLE
	select CONSOLE_POLL
	help
		When selected, the ACP serial driver won't use interrupts.
		This is only intended to be used for debugging.

		If unsure, say N.

config LSI_NET
	bool "Network interface for LSI's APP and ACP"
	help
	  Network interface driver for LSI's APP and ACP series boards.

config LSI_NET_NUM_RX_DESC
	int "NIC driver: Number of receive descriptors"
	depends on LSI_NET
	default "4"
	help
          The number of receive descriptors to allocate.

config LSI_NET_RX_BUF_SZ
    int "NIC driver: Size of the receive buffer"
    depends on LSI_NET
    default "32768"
    help
        The size of the receive buffer.

config LSI_NET_NUM_TX_DESC
    int "NIC driver: Number of transmit descriptors"
    depends on LSI_NET
    default "4"
    help
        The number of transmit descriptors to allocate.

config LSI_NET_TX_BUF_SZ
    int "NIC driver: Size of the transmit buffer"
    depends on LSI_NET
    default "32768"
    help
        The size of the transmit buffer.

endmenu
```

## drivers/mxc/Kconfig
```kconfig
# drivers/mxc/Kconfig

if ARCH_MXC

menu "MXC support drivers"

source "drivers/mxc/gpu-viv/Kconfig"

endmenu

endif

source "drivers/mxc/mipi/Kconfig"
```

## drivers/net/cns3xxx/Kconfig
```kconfig
menu "CNS3XXX Gigabit Switch Support"
	depends on ARCH_CNS3XXX

config CNS3XXX_GSW
	tristate "CNS3XXX Gigabit Switch Driver Support"
	depends on ARCH_CNS3XXX
	select CNS3XXX_PSE_INIT
	help
	  CNS3XXX layer-2 Packet Switching Enging(PSE) is a 5-port Layer-2
	  non-blocking shared-memory switch fabric: 3 MAC ports are exposed
	  for external connections, and the other two are used internally for
	  CPU port, and L2/L3/L4 Packet Processing Engine(PPE) respectively.

config CNS3XXX_ETHADDR_IN_FLASH
	bool "CNS3XXX MAC address in flash"
	depends on CNS3XXX_GSW && MTD
	help
	  Say Y if you want to load MAC address from flash.

choice
	prompt "Load MAC address from ..."
	depends on CNS3XXX_ETHADDR_IN_FLASH
	default MAC_IN_PARALLEL_FLASH

config CNS3XXX_MAC_IN_PARALLEL_FLASH
	bool "Parallel Flash"

config CNS3XXX_MAC_IN_SPI_FLASH
	bool "SPI Flash"

endchoice

config CNS3XXX_PSE_INIT
	tristate "CNS3XXX PSE Initialize part"
	depends on ARCH_CNS3XXX && CNS3XXX_GSW
	default m if CNS3XXX_GSW=m
	default y if CNS3XXX_GSW=y
	help
	  CNS3XXX layer-2 Packet Switching Enging(PSE) is a 5-port Layer-2
	  non-blocking shared-memory switch fabric: 3 MAC ports are exposed
	  for external connections, and the other two are used internally for
	  CPU port, and L2/L3/L4 Packet Processing Engine(PPE) respectively.

choice
	prompt "Board Configuration"
	depends on CNS3XXX_PSE_INIT
	default CNS3XXX_GSW_VB if CONFIG_MACH_CNS3420VB=y

config CNS3XXX_GSW_VB
	bool "Validation Board 1.x"
	select GPIO_CNS3XXX
	help
	  This configuration is used for CNS3420 Validation Board version:
	  1.1, 1,2 and 1.3. MAC0 and MAC1 connect to Broadcom BCM53115M
	  5-port 10/100/1000 switch. MAC2 connect to IC Plus IP1001 gigabit
	  ethernet transceiver.
endchoice

endmenu
```

## drivers/net/dpa/NetCommSw/Kconfig
```kconfig
menu "Frame Manager support"

menuconfig FSL_FMAN
	bool "Freescale Frame Manager (datapath) support"
	# depends on PPC_E500MC
	default y
	---help---
	  If unsure, say Y.

if FSL_FMAN

config FSL_FMAN_TEST
	bool "FMan test module"
	default n
	---help---
	  This option compiles test code for FMan.

menu "FMAN Processor support"
choice
	depends on FSL_FMAN
	prompt "Processor Type"

config FMAN_P3040_P4080_P5020
	bool "P3040 P4080 5020"

config FMAN_P1023
        bool "P1023"

endchoice
endmenu

endif # FSL_FMAN

endmenu
```
