## Documentation/devicetree/bindings/powerpc/fsl/lbc.txt
```
* Chipselect/Local Bus

Properties:
- name : Should be localbus
- compatible :	should include "fsl,elbc" for processors which have all eLBC
		interrupts routed to Int9(eLBC). should include
		"fsl,p3041-rev1.0-elbc" for processors which have eLBC
		error interrupts routed to Int0 while eLBC event interrupts
		routed to Int9.
- interrupts    : <interrupt mapping for eLBC IRQ>
		should be one or two. one is for compatible "fsl,elbc", two
		are for compatible "fsl,p3041-rev1.0-elbc". The first of the
		two is for eLBC event interrupt, the second of the two is for
		eLBC error interrupt.
- #address-cells : Should be either two or three.  The first cell is the
                   chipselect number, and the remaining cells are the
                   offset into the chipselect.
- #size-cells : Either one or two, depending on how large each chipselect
                can be.
- ranges : Each range corresponds to a single chipselect, and cover
           the entire access window as configured.

Example 1
	/* for compatible "fsl,elbc" */
	localbus@ffe124000 {
		compatible = "fsl,p4080-elbc", "fsl,elbc", "simple-bus";
		reg = <0xf 0xfe124000 0 0x1000>;
		interrupts = <25 2 0 0>;
		#address-cells = <2>;
		#size-cells = <1>;

		ranges = <0 0 0xf 0xe8000000 0x08000000>;

		flash@0,0 {
			compatible = "cfi-flash";
			reg = <0 0 0x08000000>;
			bank-width = <2>;
			device-width = <2>;
		};
	};

Example 2
	/* for compatible "fsl,p3041-rev1.0-elbc" */
	localbus@ffe124000 {
		compatible = "fsl,p3041-rev1.0-elbc", "simple-bus";
		reg = <0xf 0xfe124000 0 0x1000>;
		interrupts = <
			25 2 0 0
			16 2 1 19
			>;
		#address-cells = <2>;
		#size-cells = <1>;

		ranges = <0 0 0xf 0xe8000000 0x08000000>;

		flash@0,0 {
			compatible = "cfi-flash";
			reg = <0 0 0x08000000>;
			bank-width = <2>;
			device-width = <2>;
		};
	};
```

## Documentation/devicetree/bindings/powerpc/fsl/qman-ceetm.txt
```
======================================================================
Freescale Queue Manager CEETM Node
======================================================================

Customer Edge Egress Traffic Management (CEETM) is the new QMAN feature and
introduced from QMan v3.0. The CEETM node desribes all the resources to support
this feature.

Required properties:
- compatible: must include "fsl,qman-ceetm".

- fsl,ceetm-lfqid-range: 2-cell value <x y>, in which x is the first LFQID and
  y is the total number of LFQIDs which should not be greater than 0x1000.

- fsl,ceetm-sp-range: 2-cell value <x y>, in which x is the fist sub portal
  number and y is the total number of sub-portals which should not be greater
  than 12.

- fsl,ceetm-lni-range: 2-cell value <x y>, in which x is the first LNI number
  and y is the total number of LNIs which should not be greater than 8.

- fsl,ceetm-channel-range : 2-cell value <x y>, in which x is the first channel
  number and y is the total number of channels which should no be greater than
  32.

Example:
        qman-ceetm@1 {
                compatible = "fsl,qman-ceetm";
                fsl,ceetm-lfqid-range = <0xf10000 0x1000>;
                fsl,ceetm-sp-range = <0 12>;
                fsl,ceetm-lni-range = <0 8>;
                fsl,ceetm-channel-range = <0 32>;
        };
```

## Documentation/devicetree/bindings/rapidio/intel,axxia-rapidio.yaml
```yaml
# SPDX-License-Identifier: (GPL-2.0-only OR BSD-2-Clause)
%YAML 1.2
---
$id: http://devicetree.org/schemas/bindings/rapidio/intel,axxia-rapidio.yaml#
$schema: http://devicetree.org/meta-schemas/core.yaml#

title: Intel Axxia Designware Serial RapidIO interface

maintainers:
  - John Jacques <john.jacques@intel.com>

description: |
  Bindings for the Intel Axxia RapidIO controllers for INTEL Axxia
  devicess. The Device revision is identified from the  RapidIO Device
  Information Capability Register (dicar). The link down monitor resets
  the interface, the handler waits for the link to go up.
  The SRIO mport driver supports local and remote configuration register
  access, Direct IO and Messaging transactions for all the Axxia AXM
  chipset (AXM55xx and X9/AXM56xx) variants.

properties:
  compatible:
    items:
      - const: axxia,axxia-rapidio

  index:
    maxItems: 1

  device_type:
    const: rapidio

  "#address-cells":
    const: 2

  "#size-cells":
    const: 2

  reg:
    maxItems: 1
    description: Should contain the sRIO Register address space.

  ranges:
    maxItems: 1
    description: |
      Ranges for the SRIO config, outbound memory and I/O regions.

  linkdown-reset:
    maxItems: 1

  interrupts:
    maxItems: 1

  outb-dmes:
    maxItems: 1

  outb-dmes:
    maxItems: 1
    type: boolean

required:
  - compatible
  - index
  - device_type
  - "#address-cells"
  - "#size-cells"
  - reg
  - ranges
  - linkdown-reset
  - interrupts
  - outb-dmes
  - enable_ds

additionalProperties: true

examples:
  - |
    rio0: rapidio@0xb000000000 {
      index = <0>;
      compatible = "axxia,axxia-rapidio";
      device_type = "rapidio";
      reg = <0xa0 0x00020000 0 0x00001000>;
      #address-cells = <2>;
      #size-cells = <2>;
      ranges = <0x0 0x0 0x00b0 0x00000000 0x0 0x40000000>;
      linkdown-reset = <0x0200 0x100 0x00a0 0x10000000
                0x0 0x000010000>;
      interrupts = <GIC_SPI 129 IRQ_TYPE_LEVEL_HIGH>;
      outb-dmes = <2 0x00000003 1 0x00000000>;
      enable_ds = <1>;
    };

...
```

## Documentation/devicetree/bindings/usb/intel,axxia-dwc3.yaml
```yaml
# SPDX-License-Identifier: (GPL-2.0-only OR BSD-2-Clause)
%YAML 1.2
---
$id: http://devicetree.org/schemas/bindings/usb/intel,axxia-dwc3.yaml#
$schema: http://devicetree.org/meta-schemas/core.yaml#

title: Intel Axxia DWC3 USB SoC controller

maintainers:
  - John Jacques <john.jacques@intel.com>

description: |
  Support of USB3 functionality in Intel's Axxia AXM56xx and AXC67xx
  families of devices.

properties:
  compatible:
    items:
      - const: axxia,axxia-dwc3
      - const: snps,dwc3

  dma-coherent:
    description: Present if DMA operations are coherent.

  "#address-cells":
    const: 2

  "#size-cells":
    const: 2

  clocks:
    minItems: 3
    description: |
      A list of phandle and clock-specifier pairs for the clocks
      listed in clock-names.

  clock-names:
    items:
      - const: bus_early
      - const: ref
      - const: suspend

  ranges:
    description: |
      Allows valid 1:1 translation between child's address space and
      parent's address space.

  reg:
    maxItems: 1

  interrupts:
    maxItems: 1

  dr_mode:
    enum:
      - host
      - otg
      - peripheral

required:
  - compatible
  - dma-coherent
  - "#address-cells"
  - "#size-cells"
  - clocks
  - clocks-names
  - ranges
  - reg
  - interrupts
  - dr_mode

additionalProperties: true

examples:
  - |
    usb0: usb@9000000000 {
          compatible = "axxia,axxia-dwc3","snps,dwc3";
          dma-coherent;
          #address-cells = <2>;
          #size-cells = <2>;
          clocks = <&clk_per>,<&clk_per>,<&clk_per>;
          clock-names = "bus_early","ref","suspend";
          ranges;
          reg = <0x90 0x00000000 0 0x100000>;
          interrupts = <GIC_SPI 90 IRQ_TYPE_LEVEL_HIGH>;
          dr_mode = "host";
    };

...
```

## Documentation/devicetree/bindings/usb/intel,axxia-ehci.yaml
```yaml
# SPDX-License-Identifier: (GPL-2.0-only OR BSD-2-Clause)
%YAML 1.2
---
$id: http://devicetree.org/schemas/usb/intel,axxia-ehci.yaml#
$schema: http://devicetree.org/meta-schemas/core.yaml#

title: Intel Axxia eHCI USB SoC controller (CI13612A)

maintainers:
  - John Jacques <john.jacques@intel.com>

description: |
  Bindings for CI13612A USB HighSpeed USB OnTheGo Controller found on
  the Axxia AXM55xx family of devices. The driver does not support
  isochronous transfers and doesn't  implement OTG nor USB device
  controllers.

properties:
  compatible:
    items:
      - const: axxia,acp-usb

  device_type:
    items:
      - const: usb

  reg:
    maxItems: 2

  interrupts:
    maxItems: 1

  dma-coherent:
    description: True if DMA operations are coherent.
    maxItems: 1
    type: boolean

required:
  - compatible
  - device_type
  - reg
  - interrupts
  - dma-coherent

additionalProperties: true

examples:
  - |
    usb0: usb@004a4000 {
          compatible = "axxia,acp-usb";
          device_type = "usb";
          reg = <0x20 0x10140000 0x0 0020000>,
                <0x20 0x10094000 0x0 0002000>;
          interrupts = <0 55 4>;
          dma-coherent = <1>;
     };

...
```

## Documentation/devicetree/bindings/watchdog/sp804-axxia-wdt.yaml
```yaml
# SPDX-License-Identifier: (GPL-2.0-only OR BSD-2-Clause)
%YAML 1.2
---
$id: http://devicetree.org/schemas/watchdog/sp804-axxia-wdt.yaml#
$schema: http://devicetree.org/meta-schemas/core.yaml#

title: Intel Axxia sp804-wdt watchdog device

maintainers:
  - Per Hallsmark <per.hallsmark@windriver.com>

description: |
  Bindings for sp804-wdt driver which handles the CPU watchdog timer
  on the Intel Axxia AXM56xx family of devices.

properties:
  compatible:
    items:
      - const: arm,sp804_wdt_axxia
      - const: arm,primecell

  arm,primecell-periphid:
    $ref: /schemas/types.yaml#/definitions/uint32
    description: |
      Contains the PrimeCell Peripheral ID, it overrides the ID
      provided by the HW.

  reg:
    maxItems: 1

  interrupts:
    maxItems: 1

  clocks:
    maxItems: 1
    description: Must contain an entry for each entry in clock-names.

  clock-names:
    items:
      - const: apb_pclk

required:
  - compatible
  - "arm,primecell-periphid"
  - reg
  - interrupts
  - clocks
  - clock-names

additionalProperties: true

examples:
  - |
    watchdog0: watchdog@0x80802200e0 {
               compatible = "arm,sp804_wdt_axxia", "arm,primecell";
               arm,primecell-periphid = <0x00141804>;
               reg = <0x80 0x802200e0 0 0x1000>;
               interrupts = <GIC_SPI 36 IRQ_TYPE_LEVEL_HIGH>;
               clocks = <&clk_per 0>;
               clock-names = "apb_pclk";
    };

...
```

## arch/arm/mach-cns3xxx/Kconfig
```kconfig
menu "CNS3XXX platform type"
	depends on ARCH_CNS3XXX

config MACH_CNS3420VB
	bool "Support for CNS3420 Validation Board"
	select ARCH_WANT_OPTIONAL_GPIOLIB
	help
	  Include support for the Cavium Networks CNS3420 MPCore Platform
	  Baseboard.
	  This is a platform with an on-board ARM11 MPCore and has support
	  for USB, USB-OTG, MMC/SD/SDIO, SATA, PCI-E, etc.

config CNS3XXX_DMAC
	bool "Support for CNS3XXX DMAC"
	depends on ARCH_CNS3XXX
	help
	  Enable support for the CNS3XXX DMA controllers.

endmenu
```

## arch/arm/mach-spear13xx/Kconfig
```kconfig
#
# SPEAr13XX Machine configuration file
#

if ARCH_SPEAR13XX

menu "SPEAr13xx Implementations"
config MACH_SPEAR1300_EVB
	bool "SPEAr1300 Evaluation Board"
	select CPU_SPEAR1300
	help
	  Supports ST SPEAr1300 Evaluation Board

config MACH_SPEAR1310_REVA_EVB
	bool "SPEAr1310 RevA Evaluation Board"
	select CPU_SPEAR1310_REVA
	help
	  Supports ST SPEAr1310 RevA Evaluation Board

config MACH_R1801E
	bool "ZT R1801E SOM board, based upon SPEAr1310 RevA Device"
	select CPU_SPEAR1310_REVA
	help
	  Supports ZT's R1801E SOM board based upon ST SPEAr1310 RevA
	  device

config MACH_SPEAR1310_EVB
	bool "SPEAr1310 Evaluation Board"
	select CPU_SPEAR1310
	help
	  Supports ST SPEAr1310 Evaluation Board

config MACH_SPEAR1340_EVB
	bool "SPEAr1340 Evaluation Board"
	select CPU_SPEAR1340
	help
	  Supports ST SPEAr1340 Evaluation Board

config MACH_SPEAR_HURRICANE
	bool "NComputing SPEAr Hurricane Board"
	select CPU_SPEAR1340
	help
	  Supports NComputing SPEAr Hurricane Board

config MACH_SPEAR1340_LCAD
	bool "SPEAr1340 Low Cost Access Device (LCAD) Board"
	select CPU_SPEAR1340
	help
	  Supports SPEAr1340 Low Cost Access Device (LCAD) Board

config SPEAR1340_PLUG_BOARDS
	bool "SPEAr1340 Plug Boards"
	depends on MACH_SPEAR1340_EVB && SPEAR_PLUG_BOARDS
	help
	  Supports ST SPEAr1340 Plug boards

config MACH_SPEAR900_EVB
	bool "SPEAr900 Evaluation Board"
	select CPU_SPEAR900
	help
	  Supports ST SPEAr900 Evaluation Board

endmenu

config CPU_SPEAR1300
	bool "SPEAr1300"
	help
	  Supports ST SPEAr1300 Machine

config CPU_SPEAR1310_REVA
	bool "SPEAr1310 RevA"
	help
	  Supports ST SPEAr1310 RevA Machine

config CPU_SPEAR1310
	bool "SPEAr1310"
	help
	  Supports ST SPEAr1310 Machine

config CPU_SPEAR1340
	bool "SPEAr1340"
	help
	  Supports ST SPEAr1340 Machine

config CPU_SPEAR900
	bool "SPEAr900"
	help
	  Supports ST SPEAr900 Machine

config DW_PCIE
	bool "Synopsys Designware PCIe Host Controller"
	depends on PCIEPORTBUS
	help
	  Supports Synopsys Designware PCIe Dual mode controller as a Host

config SPEAR_PCIE_REV341
	depends on DW_PCIE
	bool "SPEAr PCIe REV 3.41"
	help
	  Supports ST SPEAr PCIe Rev 3.41

config SPEAR_PCIE_REV370
	depends on DW_PCIE
	bool "SPEAr PCIe REV 3.70"
	help
	  Supports ST SPEAr PCIe Rev 3.70

config USE_PLGPIO
	bool "Use PLGPIOs for power control on ZT R1801E SOM board"
	depends on MACH_R1801E
	help
	  Enable this to use pl-gpios on ZT's R1801E SOM board for
	  power control device

endif #ARCH_SPEAR13XX
```

## arch/arm/plat-spear/Kconfig
```kconfig
#
# SPEAr Platform configuration file
#

if PLAT_SPEAR

choice
	prompt "ST SPEAr Family"
	default ARCH_SPEAR3XX

config ARCH_SPEAR3XX
	bool "SPEAr3XX"
	select ARM_VIC
	select CPU_ARM926T
	help
	  Supports for ARM's SPEAR3XX family

config ARCH_SPEAR6XX
	bool "SPEAr6XX"
	select ARM_VIC
	select CPU_ARM926T
	help
	  Supports for ARM's SPEAR6XX family

config ARCH_SPEAR13XX
	bool "SPEAr13XX"
	select ARM_GIC
	select CPU_V7
	select ARCH_SUPPORTS_MSI
	select HAVE_SMP
	select MIGHT_HAVE_CACHE_L2X0
	select ARCH_SUPPORTS_MSI
	select MIGHT_HAVE_PCI

	help
	  Supports for ARM's SPEAR13XX family

endchoice

# Adding SPEAr machine specific configuration files
source "arch/arm/mach-spear3xx/Kconfig"
source "arch/arm/mach-spear6xx/Kconfig"

# Adding SPEAr13xx machine specific configuration files
source "arch/arm/mach-spear13xx/Kconfig"

endif
```

## arch/arm/plat-spear13xx/Kconfig
```kconfig
#
# SPEAr Platform configuration file
#

if PLAT_SPEAR

choice
	prompt "ST SPEAr Family"
	default ARCH_SPEAR3XX

config ARCH_SPEAR13XX
	bool "SPEAr13XX"
	select ARM_GIC
	select CPU_V7
	select ARCH_SUPPORTS_MSI
	select HAVE_SMP
	select MIGHT_HAVE_CACHE_L2X0
	select ARCH_SUPPORTS_MSI
	select MIGHT_HAVE_PCI

	help
	  Supports for ARM's SPEAR13XX family

config ARCH_SPEAR3XX
	bool "SPEAr3XX"
	select ARM_VIC
	select CPU_ARM926T
	help
	  Supports for ARM's SPEAR3XX family

config ARCH_SPEAR6XX
	bool "SPEAr6XX"
	select ARM_VIC
	select CPU_ARM926T
	help
	  Supports for ARM's SPEAR6XX family

endchoice

config SPEAR_PLUG_BOARDS
	bool "SPEAr Plug Boards"
	help
	  Supports ST SPEAr Plug boards

# Adding SPEAr machine specific configuration files
source "arch/arm/mach-spear13xx/Kconfig"
source "arch/arm/mach-spear3xx/Kconfig"
source "arch/arm/mach-spear6xx/Kconfig"

config SPEAR_PWM
	tristate "SPEAr Pulse Width Modulator"
	depends on CPU_SPEAR320 || CPU_SPEAR1340
	default y
	help
	  Support for ST Microelectronics Pulse Width Modulator present on SPEAr Platform.

endif
```
