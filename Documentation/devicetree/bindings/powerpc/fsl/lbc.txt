## drivers/net/ethernet/freescale/Kconfig
```kconfig
#
# Freescale device configuration
#

config NET_VENDOR_FREESCALE
	bool "Freescale devices"
	default y
	depends on FSL_SOC || QUICC_ENGINE || CPM1 || CPM2 || PPC_MPC512x || \
		   M523x || M527x || M5272 || M528x || M520x || M532x || \
		   ARCH_MXC || ARCH_MXS || (PPC_MPC52xx && PPC_BESTCOMM)
	---help---
	  If you have a network (Ethernet) card belonging to this class, say Y
	  and read the Ethernet-HOWTO, available from
	  <http://www.tldp.org/docs.html#howto>.

	  Note that the answer to this question doesn't directly affect the
	  kernel: saying N will just cause the configurator to skip all
	  the questions about Freescale devices. If you say Y, you will be
	  asked for your specific card in the following questions.

if NET_VENDOR_FREESCALE

config FEC
	tristate "FEC ethernet controller (of ColdFire and some i.MX CPUs)"
	depends on (M523x || M527x || M5272 || M528x || M520x || M532x || \
		   ARCH_MXC || SOC_IMX28)
	default ARCH_MXC || SOC_IMX28 if ARM
	select PHYLIB
	---help---
	  Say Y here if you want to use the built-in 10/100 Fast ethernet
	  controller on some Motorola ColdFire and Freescale i.MX processors.

config FEC_MPC52xx
	tristate "FEC MPC52xx driver"
	depends on PPC_MPC52xx && PPC_BESTCOMM
	select CRC32
	select PHYLIB
	select PPC_BESTCOMM_FEC
	---help---
	  This option enables support for the MPC5200's on-chip
	  Fast Ethernet Controller
	  If compiled as module, it will be called fec_mpc52xx.

config FEC_MPC52xx_MDIO
	bool "FEC MPC52xx MDIO bus driver"
	depends on FEC_MPC52xx
	default y
	---help---
	  The MPC5200's FEC can connect to the Ethernet either with
	  an external MII PHY chip or 10 Mbps 7-wire interface
	  (Motorola? industry standard).
	  If your board uses an external PHY connected to FEC, enable this.
	  If not sure, enable.
	  If compiled as module, it will be called fec_mpc52xx_phy.

source "drivers/net/ethernet/freescale/fs_enet/Kconfig"

config FSL_PQ_MDIO
	tristate "Freescale PQ MDIO"
	depends on FSL_SOC
	select PHYLIB
	---help---
	  This driver supports the MDIO bus used by the gianfar and UCC drivers.

source "drivers/net/ethernet/freescale/dpa/NetCommSw/Kconfig"

config RX_TX_BUFF_XCHG
        default n
	bool "RX and TX ring buffer exchange for Routed packets"
	depends on GIANFAR && EXPERIMENTAL
	---help---
	  Enable this flag to get better throughput for the routing functionality.
	  Enhances the performance for IPv4 Routing, NAT forwarding.
 
config GFAR_HW_TCP_RECEIVE_OFFLOAD
	default n
	bool "Hardware TCP receive offload"
	depends on GIANFAR && EXPERIMENTAL && !BONDING
	help
	  Hardware offload receive large TCP data.

	  Inserts TCP stream rules into eTSEC filer table,
	  to offload TCP receive.

config UCC_GETH
	tristate "Freescale QE Gigabit Ethernet"
	depends on QUICC_ENGINE
	select FSL_PQ_MDIO
	select PHYLIB
	---help---
	  This driver supports the Gigabit Ethernet mode of the QUICC Engine,
	  which is available on some Freescale SOCs.

config UGETH_TX_ON_DEMAND
	bool "Transmit on Demand support"
	depends on UCC_GETH

config GIANFAR
	tristate "Gianfar Ethernet"
	depends on FSL_SOC
	select FSL_PQ_MDIO
	select PHYLIB
	select CRC32
	---help---
	  This driver supports the Gigabit TSEC on the MPC83xx, MPC85xx,
	  and MPC86xx family of chips, and the FEC on the 8540.

config GIANFAR_L2SRAM
	bool "BDs in L2SRAM allocation"
	depends on (GIANFAR && FSL_SOC_BOOKE)
	select FSL_85XX_CACHE_SRAM
	help
	  This option supports the allocation of Buffer Descriptors in L2 SRAM.
	  cache-sram kernel command line parameter should be passed accordingly,
	  otherwise the driver will fall back to normal memory operation.

config DPA
	bool "Freescale Data Path Frame Manager Ethernet"
	depends on FSL_SOC && FSL_BMAN && FSL_QMAN && FSL_FMAN
	select PHYLIB

config DPA_OFFLINE_PORTS
	bool "Offline Ports support"
	depends on DPA
	default y
	help
	  The Offline Parsing / Host Command ports (short: OH ports, of Offline ports) provide
	  most of the functionality of the regular, online ports, except they receive their
	  frames from a core or an accelerator on the SoC, via QMan frame queues,
	  rather than directly from the network.
	  Offline ports are configured via PCD (Parse-Classify-Distribute) schemes, just like
	  any online FMan port. They deliver the processed frames to frame queues, according
	  to the applied PCD configurations.

	  Choosing this feature will not impact the functionality and/or performance of the system,
	  so it is safe to have it.

config DPAA_ETH_SG_SUPPORT
	bool "Add support for S/G frames in the DPAA Ethernet driver"
	depends on DPA
	default n
	help
	  Configure this to add S/G frames support in the DPAA Ethernet driver.
	  Please note this replaces the optimal processing code also for non S/G frames.

config FSL_DPA_1588
	tristate "IEEE 1588-compliant timestamping"
	depends on DPA
	default n

choice DPA_ETH_WQ_ASSIGN
	prompt "WorkQueue assignment scheme for FrameQueues"
	default DPA_ETH_WQ_MULTI
	help
	  Selects the FrameQueue to WorkQueue assignment scheme.

	config DPA_ETH_WQ_LEGACY
		bool "Legacy WQ assignment"
		help
		  Statically-defined FQIDs are round-robin assigned to all WQs (0..7). PCD queues are always
		  in this category. Other frame queues may be those used for "MAC-less" or "shared MAC" configurations
		  of the driver.
		  Dynamically-defined FQIDs all go to WQ7.
	config DPA_ETH_WQ_MULTI
		bool "Multi-WQ assignment"
		help
		  Tx Confirmation FQs go to WQ1.
		  Rx Default, Tx and PCD FQs go to WQ3.
		  Rx Error and Tx Error FQs go to WQ2.
endchoice

config DPAA_ETH_UNIT_TESTS
	bool "Run Unit Tests for DPAA Ethernet"
	depends on DPA
	default y

endif # NET_VENDOR_FREESCALE
```

## drivers/soc/marvell/Kconfig
```kconfig
#
# MARVELL SoC drivers
#

menu "Marvell SoC drivers"

config GTI_WATCHDOG
	tristate "GTI Watchdog driver"
	depends on ARM64
	help
	  GTI Watchdog driver, provides ioctl's for applications to
	  setup and enable the NMI Watchdog and also provides
	  an mmap() interface to map GTI device memory into process
	  address space for the application to directly poke the
	  GTI watchdog without any kernel support and entry.

config HW_CSR_ACCESS
	tristate "Access HW Device Config Space"
	default m
	help
	  provides an interface which enables user space utility to read from or to write
	  to HW Device Config Space Registers, Contexts, Memory.

config MARVELL_FWLOG
	tristate "firmware log interface"
	depends on ARM64
	help
	  Provides interface to read firmware boot logs. Firmware bootlogs are saved
	  in memory that is accessible from kernel. Enabling this option allows the
	  user to dump the firmware boot logs.

	  Firmware needs to build with `RECORD_FWLOG=1` to see the boot logs and
	  U-boot config `CONFIG_FWLOG_TTYMEM` is also required to have this feature
	  validated from linux.

	  Say Y here if you want to dump the firmware boot logs from linux shell. This
	  option is available only for Octeon10 and OcteonTX2 platforms.

config MVMDIO_UIO
	tristate "Marvell MDIO interface driver"
	  default m
	select MDIO_THUNDER
	help
	  Select this option if you want to provide an interface for userspace
	  PHY drivers to access Marvell's MDIO bus.

config MARVELL_CN10K_SERDES_DIAGNOSTICS
	tristate "Marvell SerDes diagnostics debugfs driver"
	default m
	depends on DEBUG_FS
	help
	  Select this option if you want to enable SerDes diagnostics
	  interface for performing PRBS, setting Loopback mode or
	  reading/writing Tx/Rx tuning parameters.
endmenu
```

## drivers/staging/fsl_rman/Kconfig
```kconfig
config FSL_RMAN_UIO
	bool "Freescale RapidIO Message Manager support"
	depends on FSL_DPA && UIO
	default y
```

## drivers/tdm/device/Kconfig
```kconfig
#
# Sensor device configuration
#

menu "TDM Device support"

config TDM_FSL_STARLITE
        tristate "Driver for Freescale Starlite TDM controller"
        depends on FSL_SOC
        ---help---
          This is a driver for Freescale Starlite TDM controller. The controller
          is found in various Freescale SOCs viz MPC8315, P1020. The TDM driver
          basically multiplexes and demultiplexes data from different channels.
          The TDM can interface SLIC kind of devices.
endmenu
```

## drivers/tdm/line_ctrl/Kconfig
```kconfig
#
# TDM line control driver config file
#


config SLIC_ZARLINK
	tristate "Zarlink Slic intialization Module"
		default n
		---help---
		  This module initialize and configure the zarlink slic
```

## drivers/tdm/test/Kconfig
```kconfig
#
# TDM line control driver config file
#


config TDM_TEST
	tristate "TDM test Module"
	default n
	---help---
	  This TDM test module is a small test module which
	  registers with the TDM core(framework) and sets up
	  a TDM Voice path between Port 0 and Port 1 for each slic.
```

## drivers/usb/otg/Kconfig
```kconfig
#
# USB OTG infrastructure may be needed for peripheral-only, host-only,
# or OTG-capable configurations when OTG transceivers or controllers
# are used.
#

comment "OTG and related infrastructure"

config USB_OTG_UTILS
	bool
	help
	  Select this to make sure the build includes objects from
	  the OTG infrastructure directory.

if USB || USB_GADGET

#
# USB Transceiver Drivers
#
config USB_GPIO_VBUS
	tristate "GPIO based peripheral-only VBUS sensing 'transceiver'"
	depends on GENERIC_GPIO
	select USB_OTG_UTILS
	help
	  Provides simple GPIO VBUS sensing for controllers with an
	  internal transceiver via the otg_transceiver interface, and
	  optionally control of a D+ pullup GPIO as well as a VBUS
	  current limit regulator.

config ISP1301_OMAP
	tristate "Philips ISP1301 with OMAP OTG"
	depends on I2C && ARCH_OMAP_OTG
	select USB_OTG_UTILS
	help
	  If you say yes here you get support for the Philips ISP1301
	  USB-On-The-Go transceiver working with the OMAP OTG controller.
	  The ISP1301 is a full speed USB  transceiver which is used in
	  products including H2, H3, and H4 development boards for Texas
	  Instruments OMAP processors.

	  This driver can also be built as a module.  If so, the module
	  will be called isp1301_omap.

config USB_ULPI
	bool "Generic ULPI Transceiver Driver"
	depends on ARM
	select USB_OTG_UTILS
	help
	  Enable this to support ULPI connected USB OTG transceivers which
	  are likely found on embedded boards.

	  The only chip currently supported is NXP's ISP1504

config TWL4030_USB
	tristate "TWL4030 USB Transceiver Driver"
	depends on TWL4030_CORE && REGULATOR_TWL4030
	select USB_OTG_UTILS
	help
	  Enable this to support the USB OTG transceiver on TWL4030
	  family chips (including the TWL5030 and TPS659x0 devices).
	  This transceiver supports high and full speed devices plus,
	  in host mode, low speed.

config NOP_USB_XCEIV
	tristate "NOP USB Transceiver Driver"
	select USB_OTG_UTILS
	help
	 this driver is to be used by all the usb transceiver which are either
	 built-in with usb ip or which are autonomous and doesn't require any
	 phy programming such as ISP1x04 etc.

config USB_CNS3XXX_OTG
	tristate "Cavium CNS3XXX OTG Module"
	depends on USB
	select USB_OTG_UTILS
	---help---
	  Cavium CNS3XXX USB OTG Chipset support

config FSL_USB2_OTG
	bool "Freescale USB OTG Transceiver Driver"
	depends on USB_EHCI_FSL
	select USB_OTG
	select USB_OTG_UTILS
	help
	  Enable this to support Freescale USB OTG transceiver.

choice
        prompt "OTG function includes"
        depends on USB_CNS3XXX_OTG
        default USB_CNS3XXX_OTG_BOTH

config USB_CNS3XXX_OTG_BOTH
	bool "both HCD and PCD"

config USB_CNS3XXX_OTG_HCD_ONLY
	bool "HCD only"

config USB_CNS3XXX_OTG_PCD_ONLY
	bool "PCD only"

endchoice
config USB_CNS3XXX_OTG_ENABLE_OTG_DRVVBUS
	bool "Enable OTG_DRVVBUS"
	depends on USB_CNS3XXX_OTG
	default y
	---help---
	 The Power control IC (FB6862B), which is located around the OTG mini
	 USB type A/B receptacle, in some early EVB board v1.0/v1.1(#1~#22) is
	 incorrect(FB6862A), and need to be patched so that VBUS can be applied
	 properly. In that case, we don't use the OTG_DRVVBUS to control the
	 VBUS.

	 Check the board that you are using, if the IC is FB6862B, say Y.
	 Otherwise, say N.

endif # USB || OTG
```

## drivers/wrhv/Kconfig
```kconfig
menuconfig WRHV_VIRTIO
	bool "Virtual devices support for WindRiver Hypervisor Guest OS"
	depends on WRHV
	select VIRTIO
	---help---
	  This provides support for the virtio based paravirtual device on
	  the WindRiver Hypervisor Guest OS.

if WRHV_VIRTIO

config WRHV_FRAME_TRANSITION_INTERRUPT_TEST
	bool "Frame transition interrupt test"
	depends on WRHV_SAFETY_PROFILE
	default n
	---help---
	  Enable testing the start frame and end frame transition interrupt
	  for Certifiable Hypervisor.

config WRHV_VIRTIO_SERIAL
	bool "Virtual serial device support for WindRiver Hypervisor Guest OS"
	depends on !WRHV_DUART && !SERIAL_8250
	select VIRTIO_CONSOLE
	---help---
	  This provides support for the virtual serial device support for
	  WindRiver Hypervisor Guest OS.

config WRHV_VIRTIO_SERIAL_CONSOLE
	bool "Virtual serial console support for WindRiver Hypervisor Guest OS"
	depends on WRHV_VIRTIO_SERIAL
	---help---
	  If you say Y here, it will be possible to user the virtual
	  serial as a system console.

endif  # WRHV_VIRTIO
```

## init/Kconfig.wrhv
```kconfig
config WRHV
	bool "Wind River Hypervisor Virtualization"
	default y
	depends on PARAVIRT
	help
	  This option is provided to enable the Wind River virtualization in the
	  Linux Kernel.
	select SERIAL_CORE
	select SERIAL_CORE_CONSOLE

config WRHV_CERT
	bool "Certifiable Hypervisor"
	default n
	depends on WRHV
	help
	  This options select certifiable hypervisor virtualization extensions
	  in the Linux Kernel
	select WRHV_COREVBI_ONLY

config WRHV_COREVBI_ONLY
	bool "Allow core VBI only"
	default n
	depends on WRHV
	help
	  Only allow use of the core virtual board interface, not the optional parts

config DEBUG_VIRTUAL_IRQS
	bool "Debug VIOAPIC with software IRQ"
	default n
	depends on WRHV
```
