// SPDX-License-Identifier: GPL-2.0
// Copyright (C) 2021 INTEL Corporation

/ {
	cpus {
		#address-cells = <1>;
		#size-cells = <0>;

		cpu@0 {
			device_type = "cpu";
			compatible = "arm,armv8";
			reg = <0x00>;
			enable-method = "psci";
		};

		cpu@1 {
			device_type = "cpu";
			compatible = "arm,armv8";
			reg = <0x01>;
			enable-method = "psci";
		};
	};
};
