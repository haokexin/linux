/dts-v1/;
/plugin/;
/ {
	fragment@0 {
		target-path = "/soc/base_fpga_region";
		__overlay__ {
			#address-cells = <2>;
			#size-cells = <2>;

			firmware-name = "soc_s10_fpga_config.rbf";
			config-complete-timeout-us = <2000000>;
		};
	};
};

