// SPDX-License-Identifier: GPL-2.0-or-later
/*
 * Copyright (C) 2023 Wind River Systems, Inc.
 *
 * This program is free software; you can redistribute it and/or modify
 * it under the terms of the GNU General Public License as published by
 * the Free Software Foundation; either version 2 of the License, or
 * (at your option) any later version.
 *
 * Based on s32g274a-rdb2.dts
 */

/dts-v1/;
#include "s32g274a-aptiv.dtsi"
