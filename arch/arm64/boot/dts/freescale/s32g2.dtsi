// SPDX-License-Identifier: GPL-2.0-or-later OR MIT
/*
 * NXP S32G2 SoC family
 *
 * Copyright (c) 2021 SUSE LLC
 * Copyright (c) 2017-2021 NXP
 * Copyright 2021-2022 NXP
 */

#include "s32g.dtsi"

/ {
	compatible = "nxp,s32g2";
};
