#include <dt-bindings/media/bst-isp.h>

compatible = "bst,ox08b-yuv-hil";
sensor-addr = <0x36>;
data-type = <DT_YUV422_8B>;
reg-width = <WORD_REG_BYTE_VAL>;

ser-fsync-tx-pin = <8>;
ser-addr = <0x42>;
