#include <dt-bindings/media/bst-isp.h>

compatible = "bst,hk_ox08b";
sensor-addr = <0x36>;
data-type = <DT_RAW14>;
sensor-fps = <20>;
reg-width = <WORD_REG_BYTE_VAL>;
algo-bin = "isp/algo/ox08b/OX08B40_raw14_HK_h120_AlgoParam.bin";
iq-bin = "isp/algo/ox08b/OX08B40_raw14_HK_h120_IqParam.bin";

ser-fsync-tx-pin = <8>;
ser-addr = <0x42>;
