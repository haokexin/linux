#include <dt-bindings/media/bst-isp.h>

compatible = "bst,custom_camera";
sensor-addr = <0x10>;
data-type = <DT_RAW10>;
sensor-fps = <60>;
reg-width = <WORD_REG_BYTE_VAL>;
algo-bin = "isp/algo/ov2311/OV2311_raw10_li_AlgoParam.bin";
iq-bin = "isp/algo/ov2311/OV2311_raw10_li_IqParam.bin";

ser-fsync-tx-pin = <8>;
ser-addr = <0x42>;

ext-addr = <0x4A>;
ext-reg-width = <BYTE_REG_BYTE_VAL>;

cfg-with-delay;

ser-init =
	<0x0001 0x04 0>,	// Set GMSL tx rate to 3Gbps
	<0x14CE 0x19 0>,	// Enable GMSL SION to improve eye quality, but it's for 6Gbps, see ERRATA
	<0x0330 0x08 5000>,	// Put MIPI RX in reset
	<0x0383 0x00 0>,	// Pixel mode
	<0x0318 0x6B 0>,	// Route data type 0x2B(RAW10) to pipe Z
	<0x0313 0x04 0>,	// Double RAW10 on pipe Z
	<0x031E 0x34 0>,	// Software override enable bpp to 20 on pipe Z
	<0x0331 0x10 0>,	// 2 data lanes, disable deskew, extended VC
	<0x0330 0x00 150000>;	// Release MIPI RX reset, continuous clock, disable VC mapping, 1x4lane mode

ext-init =
	<0x0004 0x01 500000>,
	<0x0006 0x7F 500000>,
	<0x0002 0xE1 500000>,
	<0x0005 0x00 500000>;

sensor-reset =
	<0x0103 0x01 10000>,
	<0x0107 0x01 10000>;

sensor-init =
	<0x0100 0x00 0>,
	<0x010C 0x02 0>,
	<0x010B 0x01 0>,
	<0x0300 0x01 0>,
	<0x0302 0x32 0>,
	<0x0303 0x00 0>,
	<0x0304 0x03 0>,
	<0x0305 0x02 0>,
	<0x0306 0x01 0>,
	<0x3001 0x02 0>,
	<0x3004 0x00 0>,
	<0x3005 0x00 0>,
	<0x3006 0x04 0>,
	<0x3014 0x04 0>,
	<0x301C 0xF0 0>,
	<0x3020 0x00 0>,
	<0x302C 0x00 0>,
	<0x302D 0x12 0>,
	<0x302E 0x4C 0>,
	<0x302F 0x8C 0>,
	<0x3030 0x10 0>,
	<0x303F 0x03 0>,
	<0x3103 0x00 0>,
	<0x3106 0x08 0>,
	<0x31FF 0x01 0>,
	<0x3501 0x05 0>,
	<0x3502 0xBA 0>,
	<0x3506 0x00 0>,
	<0x3507 0x00 0>,
	<0x3620 0x67 0>,
	<0x3633 0x78 0>,
	<0x3662 0x65 0>,
	<0x3666 0x00 0>,
	<0x3670 0x68 0>,
	<0x3674 0x10 0>,
	<0x3675 0x00 0>,
	<0x3680 0x84 0>,
	<0x36A2 0x04 0>,
	<0x36A3 0x80 0>,
	<0x36B0 0x00 0>,
	<0x3700 0x35 0>,
	<0x3704 0x59 0>,
	<0x3712 0x80 0>,
	<0x3713 0x02 0>,
	<0x379B 0x01 0>,
	<0x379C 0x10 0>,
	<0x3800 0x00 0>,
	<0x3801 0x00 0>,
	<0x3802 0x00 0>,
	<0x3803 0x00 0>,
	<0x3804 0x06 0>,
	<0x3805 0x4F 0>,
	<0x3806 0x05 0>,
	<0x3807 0x23 0>,
	<0x3808 0x06 0>,
	<0x3809 0x40 0>,
	<0x380A 0x05 0>,
	<0x380B 0x14 0>,
	<0x380C 0x03 0>,
	<0x380D 0x88 0>,
	<0x380E 0x05 0>,
	<0x380F 0xC2 0>,
	<0x3810 0x00 0>,
	<0x3811 0x08 0>,
	<0x3812 0x00 0>,
	<0x3813 0x08 0>,
	<0x3814 0x11 0>,
	<0x3815 0x11 0>,
	<0x3816 0x00 0>,
	<0x3817 0x00 0>,
	<0x3818 0x04 0>,
	<0x3819 0x00 0>,
	<0x3820 0x00 0>,
	<0x3821 0x00 0>,
	<0x382B 0x5A 0>,
	<0x382C 0x07 0>,
	<0x382D 0x10 0>,
	<0x3882 0x02 0>,
	<0x3883 0x60 0>,
	<0x3885 0x07 0>,
	<0x389D 0x03 0>,
	<0x38A6 0x00 0>,
	<0x38A7 0x01 0>,
	<0x38B3 0x07 0>,
	<0x38B1 0x00 0>,
	<0x38E5 0x02 0>,
	<0x38E7 0x00 0>,
	<0x38E8 0x00 0>,
	<0x3920 0xA5 0>,
	<0x3921 0x00 0>,
	<0x3922 0x00 0>,
	<0x3923 0x00 0>,
	<0x3924 0x05 0>,
	<0x3925 0x00 0>,
	<0x3926 0x00 0>,
	<0x3927 0x00 0>,
	<0x3928 0x1A 0>,
	<0x392D 0x05 0>,
	<0x392E 0xF2 0>,
	<0x392F 0x40 0>,
	<0x4001 0x00 0>,
	<0x4003 0x40 0>,
	<0x4008 0x12 0>,
	<0x4009 0x1B 0>,
	<0x400C 0x0C 0>,
	<0x400D 0x13 0>,
	<0x4010 0xF0 0>,
	<0x4011 0x00 0>,
	<0x4016 0x00 0>,
	<0x4017 0x04 0>,
	<0x4042 0x11 0>,
	<0x4043 0x70 0>,
	<0x4409 0x5F 0>,
	<0x4600 0x00 0>,
	<0x4601 0xA0 0>,
	<0x4800 0x00 0>,
	<0x4837 0x14 0>,
	<0x4F00 0x00 0>,
	<0x4F07 0x00 0>,
	<0x4F08 0x03 0>,
	<0x4F09 0x08 0>,
	<0x4F0C 0x06 0>,
	<0x4F0D 0x02 0>,
	<0x4F10 0x00 0>,
	<0x4F11 0x00 0>,
	<0x4F12 0x07 0>,
	<0x4F13 0xE2 0>,
	<0x5000 0x9F 0>,
	<0x5001 0x20 0>,
	<0x5026 0x00 0>,
	<0x5E00 0x00 0>,
	<0x5E01 0x41 0>,
	<0x0100 0x01 0>,
	<0x4500 0x74 0>,
	<0x3006 0x08 0>,
	<0x3004 0x02 0>,
	<0x3007 0x02 0>,
	<0x301C 0x20 0>,
	<0x3020 0x20 0>,
	<0x3025 0x02 0>,
	<0x3920 0xFF 0>,
	<0x3924 0x00 0>,
	<0x392C 0x00 0>,
	<0x392D 0x03 0>,
	<0x392E 0x88 0>,
	<0x392F 0xCB 0>,
	<0x3501 0x00 0>,
	<0x3502 0xAB 0>,
	<0x3508 0x01 0>,
	<0x3509 0x00 0>,
	<0x3927 0x00 0>,
	<0x3928 0xAB 0>,
	<0x3929 0x04 0>,
	<0x392A 0xD6 0>,
	// for external trigger fsync
	<0x3006 0x00 0>,
	<0x38B3 0x07 0>,
	<0x3885 0x07 0>,
	<0x382B 0x32 0>,
	<0x3670 0x68 0>,
	<0x3823 0x30 0>,
	<0x3824 0x00 0>,
	<0x3825 0x08 0>,
	<0x3826 0x05 0>,
	<0x3827 0xBE 0>;

sensor-stream-on = <0x0100 0x01 0>;
sensor-stream-off = <0x0100 0x00 0>;
