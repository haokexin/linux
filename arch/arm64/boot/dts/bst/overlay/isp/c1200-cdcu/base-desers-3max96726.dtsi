&deser0 {
	compatible = "bst,max96726";
	type = "max96726";
	ctl-mode = "fad-ctl";
	reg = <0x32>;
	i2c-port = <0>;
	csi2-port = <1>;
	lane-speed = <2400>;
	data-type = <0x2d>;
	trigger-mode = "external";
	trigger-fps = <20>;
	trigger-rx-pin = <0>;
	maxim,hsync-invert = <0>;
	maxim,vsync-invert = <0>;
	maxim,linkrx-rate = <6 3 3 3>;
	maxim,link-mode = "GMSL2";
	status = "okay";
};
&deser1 {
	compatible = "bst,max96726";
	type = "max96726";
	ctl-mode = "fad-ctl";
	reg = <0x22>;
	i2c-port = <0>;
	csi2-port = <1>;
	lane-speed = <2400>;
	data-type = <0x2d>;
	trigger-mode = "external";
	trigger-fps = <20>;
	trigger-rx-pin = <0>;
	maxim,hsync-invert = <0>;
	maxim,vsync-invert = <0>;
	maxim,linkrx-rate = <3 3 3 3>;
	maxim,link-mode = "GMSL2";
	status = "okay";
};
&deser2 {
	compatible = "bst,max96726";
	type = "max96726";
	ctl-mode = "fad-ctl";
	reg = <0x30>;
	i2c-port = <0>;
	csi2-port = <1>;
	lane-speed = <2400>;
	data-type = <0x2d>;
	trigger-mode = "external";
	trigger-fps = <20>;
	trigger-rx-pin = <0>;
	maxim,hsync-invert = <0>;
	maxim,vsync-invert = <0>;
	maxim,linkrx-rate = <3 3 3 3>;
	maxim,link-mode = "GMSL2";
	status = "okay";
};
